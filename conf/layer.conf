## conf/machine/colibri-vf.conf
```bitbake
#@TYPE: Machine
#@NAME: Toradex Colibri VF50/VF61
#@SOC: VF500/VF610
#@DESCRIPTION: Machine configuration for Toradex Colibri VF50/VF61 powered by Freescale Vybrid SoC
#@MAINTAINER: Max Krummenacher <max.krummenacher@toradex.com>

MACHINEOVERRIDES =. "vf:"

include conf/machine/include/imx-base.inc
include conf/machine/include/arm/armv7a/tune-cortexa5.inc

PREFERRED_PROVIDER_virtual/kernel ?= "linux-toradex"

KERNEL_IMAGETYPE = "zImage"

KERNEL_DEVICETREE = " \
    vf500-colibri-eval-v3.dtb \
    vf610-colibri-eval-v3.dtb \
"

KERNEL_DEVICETREE:append:use-nxp-bsp = " \
    vf500-colibri-aster.dtb \
    vf610-colibri-aster.dtb \
"

# U-Boot of our newer release read the Kernel and device tree from static UBI volumes,
# hence no need to deploy the kernel binary in the image itself
RRECOMMENDS:${KERNEL_PACKAGE_NAME}-base = ""

IMX_DEFAULT_BOOTLOADER = "u-boot-toradex"
PREFERRED_PROVIDER_u-boot-default-script ?= "u-boot-script-toradex"
PREFERRED_PROVIDER_virtual/kernel-module-mcc ?= "kernel-module-mcc-toradex"
PREFERRED_PROVIDER_virtual/kernel-module-mcc-dev ?= "kernel-module-mcc-toradex"
PREFERRED_VERSION_mqxboot ?= "1.%"
PREFERRED_VERSION_weston:use-nxp-bsp = ""

# U-Boot NAND binary includes 0x400 padding required for NAND boot
UBOOT_BINARY = "u-boot-nand.imx"
UBOOT_MAKE_TARGET = "u-boot.imx"
UBOOT_MACHINE ?= "colibri_vf_defconfig"
UBOOT_SUFFIX = "imx"

IMAGE_FSTYPES += "tar.xz ubifs"
# wic support
IMAGE_BOOT_FILES:append = " boot.scr-${MACHINE};boot.scr"
WKS_FILE_DEPENDS:append = " u-boot-default-script"
WKS_FILE = "sdimage-bootpart.wks"

# Enable free --space-fixup (-F) by default, this allows DFU updates
MKUBIFS_ARGS = " -c 8112 -e 124KiB -m 2KiB -F"
UBINIZE_ARGS = " -p 128KiB -m 2048 -s 2048"
UBI_VOLNAME = "rootfs"

SERIAL_CONSOLES = "115200;ttyLP0"

MACHINE_FEATURES += "usbgadget usbhost vfat alsa touchscreen"
```

## conf/machine/cubox-i.conf
```bitbake
#@TYPE: Machine
#@NAME: SolidRun CuBox-i and HummingBoard
#@SOC: i.MX6 Q/DL
#@DESCRIPTION: Machine configuration for SolidRun CuBox-i and HummingBoard machines
#@MAINTAINER: Carlos Rafael Giani <dv@pseudoterminal.org>

# Machine config for the SolidRun CuBox-i and HummingBoard machines.
# They all use the same machine config, since the u-boot SPL
# autodetects the machine type upon booting. MACHINEOVERRIDES includes
# all SoCs from all of these machines to let recipes include firmware
# etc. for all of these SoCs.

MACHINEOVERRIDES =. "mx6:mx6dl:mx6q:"

require conf/machine/include/imx-base.inc
require conf/machine/include/tune-cortexa9.inc

PREFERRED_PROVIDER_virtual/kernel ?= "linux-fslc"

UBOOT_MAKE_TARGET = ""
UBOOT_SUFFIX = "img"
UBOOT_CONFIG ??= "sd"
UBOOT_CONFIG[sd] = "mx6cuboxi_defconfig,sdcard"
UENV_FILENAME = "uEnv-${MACHINE}.txt"
SPL_BINARY = "SPL"

UBOOT_EXTLINUX = "1"
UBOOT_EXTLINUX_ROOT = "root=PARTUUID=${uuid}"

KERNEL_IMAGETYPE = "zImage"
KERNEL_DEVICETREE = "imx6dl-cubox-i.dtb imx6q-cubox-i.dtb imx6dl-hummingboard.dtb imx6q-hummingboard.dtb"

MACHINE_FEATURES += "pci wifi bluetooth alsa irda serial usbhost"
MACHINE_EXTRA_RRECOMMENDS += "bcm4330-nvram-config bcm4329-nvram-config"

SERIAL_CONSOLE = "115200 ttymxc0"

MACHINE_ESSENTIAL_EXTRA_RDEPENDS += " \
    kernel-image \
    kernel-devicetree \
    u-boot-fslc \
"

WKS_FILES ?= "imx-uboot-spl.wks"

IMAGE_DEPENDS_wic_append = " virtual/bootloader"

IMAGE_FSTYPES = "wic.gz"
```

## conf/machine/gk802.conf
```bitbake
#@TYPE: Machine
#@NAME: Zealz GK802
#@SOC: i.MX6Q
#@DESCRIPTION: Machine configuration for Zealz GK802

include conf/machine/include/imx-base.inc
include conf/machine/include/tune-cortexa9.inc

SOC_FAMILY = "mx6:mx6q"

PREFERRED_PROVIDER_u-boot = "u-boot-imx6dongle"
PREFERRED_PROVIDER_virtual/kernel = "linux-imx6dongle"

UBOOT_MACHINE = "gk802_config"

SERIAL_CONSOLE = "115200 ttymxc3"

MACHINE_FEATURES += " pci wifi bluetooth"
```

## conf/machine/imx233-olinuxino-maxi.conf
```bitbake
#@TYPE: Machine
#@NAME: OLIMEX iMX233-OLinuXino-Maxi
#@SOC: i.MX23
#@DESCRIPTION: Machine configuration for OLIMEX iMX233-OLinuXino-Maxi

include conf/machine/include/imx233-olinuxino.inc

MACHINE_ESSENTIAL_EXTRA_RDEPENDS += "net-persistent-mac"
```

## conf/machine/imx233-olinuxino-micro.conf
```bitbake
#@TYPE: Machine
#@NAME: OLIMEX iMX233-OLinuXino-Micro
#@SOC: i.MX23
#@DESCRIPTION: Machine configuration for OLIMEX iMX233-OLinuXino-Micro

include conf/machine/include/imx233-olinuxino.inc
```

## conf/machine/imx233-olinuxino-mini.conf
```bitbake
#@TYPE: Machine
#@NAME: OLIMEX iMX233-OLinuXino-Mini
#@SOC: i.MX23
#@DESCRIPTION: Machine configuration for OLIMEX iMX233-OLinuXino-Mini

include conf/machine/include/imx233-olinuxino.inc
```

## conf/machine/imx233-olinuxino-nano.conf
```bitbake
#@TYPE: Machine
#@NAME: OLIMEX iMX233-OLinuXino-Nano
#@SOC: i.MX23
#@DESCRIPTION: Machine configuration for OLIMEX iMX233-OLinuXino-Nano

include conf/machine/include/imx233-olinuxino.inc
```
