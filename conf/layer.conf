## conf/layer.conf
```bitbake
# We have a conf and classes directory, add to BBPATH
BBPATH .= ":${LAYERDIR}"

# We have a packages directory, add to BBFILES
BBFILES += "${LAYERDIR}/recipes-*/*/*.bb \
            ${LAYERDIR}/recipes-*/*/*.bbappend"

BBFILE_COLLECTIONS += "freescale-3rdparty"
BBFILE_PATTERN_freescale-3rdparty := "^${LAYERDIR}/"
BBFILE_PRIORITY_freescale-3rdparty = "4"

LAYERSERIES_COMPAT_freescale-3rdparty = "kirkstone langdale mickledore nanbield scarthgap"
LAYERDEPENDS_freescale-3rdparty = "core freescale-layer"
```

## conf/machine/apalis-imx6.conf
```bitbake
#@TYPE: Machine
#@NAME: Toradex Apalis iMX6Q/D
#@SOC: i.MX6Q
#@DESCRIPTION: Machine configuration for Toradex Apalis iMX6 SOM
#@MAINTAINER: Max Krummenacher <max.krummenacher@toradex.com>

MACHINEOVERRIDES =. "mx6q:"

include conf/machine/include/imx-base.inc
include conf/machine/include/arm/armv7a/tune-cortexa9.inc

PREFERRED_PROVIDER_virtual/kernel:use-nxp-bsp ??= "linux-toradex"
KBUILD_DEFCONFIG:use-nxp-bsp ?= "apalis_imx6_defconfig"
KERNEL_DEVICETREE += " \
    imx6q-apalis-eval.dtb imx6q-apalis-ixora.dtb \
    imx6q-apalis-ixora-v1.1.dtb \
"
KERNEL_DEVICETREE:append:use-nxp-bsp = " imx6q-apalis-ixora-v1.2.dtb"

KERNEL_IMAGETYPE = "zImage"
# The kernel lives in a seperate FAT partition, don't deploy it in /boot/
RRECOMMENDS:${KERNEL_PACKAGE_NAME}-base = ""

IMX_DEFAULT_BOOTLOADER = "u-boot-toradex"
PREFERRED_RPROVIDER_u-boot-default-script = "u-boot-script-toradex"

UBOOT_SUFFIX = "img"
SPL_BINARY = "SPL"
# The SPL configures the DDR RAM depending on the module it runs on. Thus there
# is no need to distingush between the different module types.
UBOOT_CONFIG ??= "spl"
UBOOT_CONFIG[spl] = "apalis_imx6_defconfig,,u-boot.img"
UBOOT_MAKE_TARGET = ""
UBOOT_ENTRYPOINT:use-mainline-bsp = "0x10008000"

IMAGE_FSTYPES += "tar.xz"
# wic support
IMAGE_BOOT_FILES:append = " boot.scr-${MACHINE};boot.scr"
WKS_FILE_DEPENDS:append = " u-boot-default-script"
WKS_FILE = "sdimage-bootpart.wks"

MACHINE_FEATURES += "screen usbgadget usbhost vfat ext2 alsa touchscreen wifi bluetooth 3g pci"
MACHINE_FIRMWARE:remove = "firmware-imx-epdc"
```

## conf/machine/ccimx6ulsbcexpress.conf
```bitbake
#@TYPE: Machine
#@NAME: ConnecCore 6UL SBC Express
#@SOC: i.MX6UL
#@DESCRIPTION: Machine configuration for ConnectCore 6UL SBC Express board.
#@MAINTAINER: Alex Gonzalez <alex.gonzalez@digi.com>

include conf/machine/include/ccimx6ulsom.inc

SERIAL_CONSOLES = "115200;ttymxc4"

KERNEL_DEVICETREE = "imx6ul-ccimx6ulsbcexpress.dtb"
```

## conf/machine/ccimx6ulsbcpro.conf
```bitbake
#@TYPE: Machine
#@NAME: ConnecCore 6UL SBC Pro
#@SOC: i.MX6UL
#@DESCRIPTION: Machine configuration for ConnectCore 6UL SBC Pro board.
#@MAINTAINER: Alex Gonzalez <alex.gonzalez@digi.com>

include conf/machine/include/ccimx6ulsom.inc

KERNEL_DEVICETREE = "imx6ul-ccimx6ulsbcpro.dtb"

SERIAL_CONSOLES = "115200;ttymxc4"
```

## conf/machine/cfa10036.conf
```bitbake
#@TYPE: Machine
#@NAME: Crystalfontz CFA-10036
#@SOC: i.MX28
#@DESCRIPTION: Machine configuration for CFA-10036
#@MAINTAINER: Alexandre Belloni <alexandre.belloni@free-electrons.com>

include conf/machine/include/cfa10036.inc
```

## conf/machine/cfa10037.conf
```bitbake
#@TYPE: Machine
#@NAME: Crystalfontz CFA-10037
#@SOC: i.MX28
#@DESCRIPTION: Machine configuration for CFA-10037
#@MAINTAINER: Alexandre Belloni <alexandre.belloni@free-electrons.com>

include conf/machine/include/cfa10036.inc

KERNEL_DEVICETREE += "imx28-cfa10037.dtb"
```

## conf/machine/cfa10049.conf
```bitbake
#@TYPE: Machine
#@NAME: Crystalfontz CFA-10049
#@SOC: i.MX28
#@DESCRIPTION: Machine configuration for CFA-10049
#@MAINTAINER: Alexandre Belloni <alexandre.belloni@free-electrons.com>

include conf/machine/include/cfa10036.inc

KERNEL_DEVICETREE += "imx28-cfa10049.dtb"

MACHINE_FEATURES += "touchscreen"
```

## conf/machine/cfa10055.conf
```bitbake
#@TYPE: Machine
#@NAME: Crystalfontz CFA-10055
#@SOC: i.MX28
#@DESCRIPTION: Machine configuration for CFA-10055
#@MAINTAINER: Alexandre Belloni <alexandre.belloni@free-electrons.com>

include conf/machine/include/cfa10036.inc

KERNEL_DEVICETREE += "imx28-cfa10055.dtb"

MACHINE_FEATURES += "touchscreen"
```

## conf/machine/cfa10056.conf
```bitbake
#@TYPE: Machine
#@NAME: Crystalfontz CFA-10056
#@SOC: i.MX28
#@DESCRIPTION: Machine configuration for CFA-10056
#@MAINTAINER: Alexandre Belloni <alexandre.belloni@free-electrons.com>

include conf/machine/include/cfa10036.inc

KERNEL_DEVICETREE += "imx28-cfa10056.dtb"

MACHINE_FEATURES += "screen"
```

## conf/machine/cfa10057.conf
```bitbake
#@TYPE: Machine
#@NAME: Crystalfontz CFA-10057
#@SOC: i.MX28
#@DESCRIPTION: Machine configuration for CFA-10057, also called CFA-920
#@MAINTAINER: Alexandre Belloni <alexandre.belloni@free-electrons.com>

include conf/machine/include/cfa10036.inc

KERNEL_DEVICETREE += "imx28-cfa10057.dtb"

MACHINE_FEATURES += "touchscreen"
```

## conf/machine/cfa10058.conf
```bitbake
#@TYPE: Machine
#@NAME: Crystalfontz CFA-10058
#@SOC: i.MX28
#@DESCRIPTION: Machine configuration for CFA-10058, also called CFA-921
#@MAINTAINER: Alexandre Belloni <alexandre.belloni@free-electrons.com>

include conf/machine/include/cfa10036.inc

KERNEL_DEVICETREE += "imx28-cfa10058.dtb"

MACHINE_FEATURES += "touchscreen"
```

## conf/machine/cgtqmx6.conf
```bitbake
#@TYPE: Machine
#@NAME: Congatec QMX6 Evaluation board
#@SOC: i.MX6 Q/DL
#@DESCRIPTION: Machine configuration for Congatec QMX6 Evaluation board
#@MAINTAINER: Alex de Cabo <alejandro.de-cabo-garcia@congatec.com>

MACHINEOVERRIDES =. "mx6:mx6dl:mx6q:"

include conf/machine/include/imx-base.inc
include conf/machine/include/tune-cortexa9.inc

PREFERRED_PROVIDER_u-boot = "u-boot-congatec"
UBOOT_MAKE_TARGET = ""
UBOOT_SUFFIX = "img"
SPL_BINARY = "SPL"
UBOOT_CONFIG ??= "cgtqmx6"

UBOOT_CONFIG[cgtqmx6] = "cgtqmx6eval_defconfig"

# Use linux kernel QMX6
PREFERRED_PROVIDER_virtual/kernel ??= "linux-congatec"
KERNEL_DEVICETREE = "imx6q-qmx6.dtb imx6dl-qmx6.dtb"
KERNEL_IMAGETYPE = "uImage"

SERIAL_CONSOLE = "115200 ttymxc1"

MACHINE_FEATURES += " pci"
```

## conf/machine/cm-fx6.conf
```bitbake
#@TYPE: Machine
#@NAME: CompuLab CM-FX6
#@SOC: i.MX6 Q/DL
#@DESCRIPTION: Machine configuration for CompuLab CM-FX6 machines
#@MAINTAINER: Valentin Raevsky <valentin@compulab.co.il>

require conf/machine/include/imx-base.inc
require conf/machine/include/tune-cortexa9.inc

SOC_FAMILY = "mx6:mx6dl:mx6q"

PREFERRED_PROVIDER_u-boot = "u-boot-compulab"
PREFERRED_PROVIDER_virtual/kernel = "linux-compulab"

UBOOT_MACHINE ?= "cm_fx6_defconfig"

KERNEL_DEVICETREE = "imx6dl-cm-fx6.dtb  imx6dl-sbc-fx6.dtb  imx6dl-sbc-fx6m.dtb  imx6q-cm-fx6.dtb  imx6q-sbc-fx6.dtb  imx6q-sbc-fx6m.dtb"

MACHINE_FEATURES += "pci wifi bluetooth alsa bluetooth serial usbhost wifi"

SERIAL_CONSOLE = "115200 ttymxc3"
```

## conf/machine/colibri-imx6.conf
```bitbake
#@TYPE: Machine
#@NAME: Toradex Colibri iMX6DL/S
#@SOC: i.MX6DL
#@DESCRIPTION: Machine configuration for Toradex Colibri iMX6 SOM
#@MAINTAINER: Max Krummenacher <max.krummenacher@toradex.com>

MACHINEOVERRIDES =. "mx6dl:"

include conf/machine/include/imx-base.inc
include conf/machine/include/arm/armv7a/tune-cortexa9.inc

PREFERRED_PROVIDER_virtual/kernel:use-nxp-bsp ??= "linux-toradex"
KBUILD_DEFCONFIG:use-nxp-bsp ?= "colibri_imx6_defconfig"
KERNEL_DEVICETREE += "imx6dl-colibri-eval-v3.dtb imx6dl-colibri-cam-eval-v3.dtb \
                      imx6dl-colibri-aster.dtb imx6dl-colibri-iris.dtb \
                      imx6dl-colibri-iris-v2.dtb"
KERNEL_DEVICETREE:use-mainline-bsp = "imx6dl-colibri-eval-v3.dtb"
KERNEL_IMAGETYPE = "zImage"
# The kernel lives in a seperate FAT partition, don't deploy it in /boot/
RRECOMMENDS:${KERNEL_PACKAGE_NAME}-base = ""

IMX_DEFAULT_BOOTLOADER = "u-boot-toradex"
PREFERRED_PROVIDER_u-boot-default-script ?= "u-boot-script-toradex"

UBOOT_SUFFIX = "img"
SPL_BINARY = "SPL"
UBOOT_CONFIG ??= "spl"
UBOOT_CONFIG[spl] = "colibri_imx6_defconfig,,u-boot.img"
UBOOT_MAKE_TARGET = ""
UBOOT_ENTRYPOINT:use-mainline-bsp = "0x10008000"

IMAGE_FSTYPES += "tar.xz"
# wic support
IMAGE_BOOT_FILES:append = " boot.scr-${MACHINE};boot.scr"
WKS_FILE_DEPENDS:append = " u-boot-default-script"
WKS_FILE = "sdimage-bootpart.wks"

MACHINE_FEATURES += "screen usbgadget usbhost vfat ext2 alsa touchscreen wifi bluetooth 3g"
MACHINE_FIRMWARE:remove = "firmware-imx-epdc"
```

## conf/machine/colibri-imx6ull.conf
```bitbake
#@TYPE: Machine
#@NAME: Toradex Colibri iMX6ULL
#@SOC: i.MX6ULL
#@DESCRIPTION: Machine configuration for Toradex Colibri iMX6 ULL SOM
#@MAINTAINER: Max Krummenacher <max.krummenacher@toradex.com>

MACHINEOVERRIDES =. "mx6ull:"

include conf/machine/include/imx-base.inc
include conf/machine/include/arm/armv7a/tune-cortexa7.inc

PREFERRED_PROVIDER_virtual/kernel:use-nxp-bsp ?= "linux-toradex"
KBUILD_DEFCONFIG:use-nxp-bsp ?= "colibri-imx6ull_defconfig"
KERNEL_DEVICETREE += " \
    imx6ull-colibri-eval-v3.dtb imx6ull-colibri-wifi-eval-v3.dtb \
"
KERNEL_DEVICETREE:append:use-nxp-bsp = " \
    imx6ull-colibri-aster.dtb imx6ull-colibri-wifi-aster.dtb \
    imx6ull-colibri-iris.dtb imx6ull-colibri-wifi-iris.dtb \
    imx6ull-colibri-iris-v2.dtb imx6ull-colibri-wifi-iris-v2.dtb \
"

KERNEL_IMAGETYPE = "zImage"
# The kernel lives in its own ubi volume.
RRECOMMENDS:${KERNEL_PACKAGE_NAME}-base = ""

IMX_DEFAULT_BOOTLOADER = "u-boot-toradex"
PREFERRED_PROVIDER_u-boot-default-script ?= "u-boot-script-toradex"

UBOOT_BINARY = "u-boot-nand.imx"
UBOOT_MAKE_TARGET = "u-boot.imx"
UBOOT_MACHINE ?= "colibri-imx6ull_defconfig"
UBOOT_SUFFIX = "imx"

IMAGE_FSTYPES += "tar.xz"
# wic support
IMAGE_BOOT_FILES:append = " boot.scr-${MACHINE};boot.scr"
WKS_FILE_DEPENDS:append = " u-boot-default-script"
WKS_FILE = "sdimage-bootpart.wks"

MACHINE_FEATURES += "screen usbgadget usbhost vfat ext2 alsa touchscreen wifi bluetooth 3g"
MACHINE_FIRMWARE:remove = "firmware-imx-epdc"
```

## conf/machine/colibri-imx7-emmc.conf
```bitbake
#@TYPE: Machine
#@NAME: Toradex Colibri iMX7 Dual 1GB (eMMC)
#@SOC: i.MX 7Dual
#@DESCRIPTION: Machine configuration for Toradex Colibri iMX7 SOM (eMMC)
#@MAINTAINER: Max Krummenacher <max.krummenacher@toradex.com>

MACHINEOVERRIDES =. "mx7:mx7d:"

include conf/machine/include/imx-base.inc
include conf/machine/include/arm/armv7a/tune-cortexa7.inc

PREFERRED_PROVIDER_virtual/kernel:use-nxp-bsp ??= "linux-toradex"
KBUILD_DEFCONFIG:use-nxp-bsp ?= "colibri_imx7_defconfig"
KERNEL_DEVICETREE = " \
    imx7d-colibri-emmc-eval-v3.dtb \
    imx7d-colibri-emmc-aster.dtb \
"
KERNEL_DEVICETREE:append:use-nxp-bsp = " \
    imx7d-colibri-emmc-iris.dtb \
    imx7d-colibri-emmc-iris-v2.dtb \
"

# The kernel lives in a seperate FAT partition, don't deploy it in /boot/
RRECOMMENDS:${KERNEL_PACKAGE_NAME}-base = ""

IMX_DEFAULT_BOOTLOADER = "u-boot-toradex"
PREFERRED_RPROVIDER_u-boot-default-script = "u-boot-script-toradex"

UBOOT_SUFFIX = "imx"
UBOOT_BINARY = "u-boot-dtb.${UBOOT_SUFFIX}"
UBOOT_MACHINE ?= "colibri_imx7_emmc_defconfig"

IMAGE_FSTYPES += "tar.xz"
IMAGE_BOOT_FILES:append = " boot.scr-${MACHINE};boot.scr"
WKS_FILE_DEPENDS:append = " u-boot-default-script"

MACHINE_FEATURES += "screen usbgadget usbhost vfat ext2 alsa touchscreen wifi bluetooth 3g"
MACHINE_FIRMWARE:remove = "firmware-imx-epdc"
```

## conf/machine/colibri-imx7-nand.conf
```bitbake
#@TYPE: Machine
#@NAME: Toradex Colibri iMX7D/S (NAND)
#@SOC: i.MX 7Dual / i.MX 7Solo
#@DESCRIPTION: Machine configuration for Toradex Colibri iMX7 SOM (NAND)
#@MAINTAINER: Max Krummenacher <max.krummenacher@toradex.com>

MACHINEOVERRIDES =. "mx7:mx7d:colibri-imx7:"

include conf/machine/include/imx-base.inc
include conf/machine/include/arm/armv7a/tune-cortexa7.inc

PREFERRED_PROVIDER_virtual/kernel:use-nxp-bsp ??= "linux-toradex"
KBUILD_DEFCONFIG:use-nxp-bsp ?= "colibri_imx7_defconfig"
KERNEL_IMAGETYPE = "zImage"

KERNEL_DEVICETREE = " \
    imx7d-colibri-eval-v3.dtb imx7s-colibri-eval-v3.dtb \
    imx7d-colibri-aster.dtb imx7s-colibri-aster.dtb \
"

KERNEL_DEVICETREE:append:use-nxp-bsp = " \
    imx7d-colibri-iris.dtb imx7s-colibri-iris.dtb \
    imx7d-colibri-iris-v2.dtb imx7s-colibri-iris-v2.dtb \
"

# U-Boot of our newer release read the Kernel and device tree from static UBI
# volumes, hence no need to deploy the kernel binary in the image itself
RRECOMMENDS:${KERNEL_PACKAGE_NAME}-base = ""

IMX_DEFAULT_BOOTLOADER = "u-boot-toradex"
PREFERRED_PROVIDER_u-boot-default-script ?= "u-boot-script-toradex"

# U-Boot NAND binary includes 0x400 padding required for NAND boot
UBOOT_BINARY = "u-boot-nand.imx"
UBOOT_MAKE_TARGET = "u-boot.imx"
UBOOT_MACHINE ?= "colibri_imx7_defconfig"
UBOOT_SUFFIX = "imx"

IMAGE_FSTYPES += "tar.xz"
# wic support
IMAGE_BOOT_FILES:append = " boot.scr-${MACHINE};boot.scr"
WKS_FILE_DEPENDS:append = " u-boot-default-script"
WKS_FILE = "sdimage-bootpart.wks"

# Enable free --space-fixup (-F) by default, this allows DFU updates
MKUBIFS_ARGS = " -c 8112 -e 124KiB -m 2KiB -F"
UBINIZE_ARGS = " -p 128KiB -m 2048 -s 2048"
UBI_VOLNAME = "rootfs"

SERIAL_CONSOLES = "115200;ttymxc0"

MACHINE_FEATURES += "screen usbgadget usbhost vfat ext2 alsa touchscreen wifi bluetooth 3g"
MACHINE_FIRMWARE:remove = "firmware-imx-epdc"
```

## conf/machine/colibri-imx7.conf
```bitbake
#@TYPE: Machine
#@NAME: Toradex Colibri iMX7D/S
#@SOC: i.MX 7Dual / i.MX 7Solo
#@DESCRIPTION: Machine configuration for Toradex Colibri iMX7 SOM
#@MAINTAINER: Max Krummenacher <max.krummenacher@toradex.com>

MACHINEOVERRIDES =. "mx7:mx7d:"

include conf/machine/include/imx-base.inc
include conf/machine/include/tune-cortexa7.inc

PREFERRED_PROVIDER_virtual/kernel ?= "linux-toradex"
KERNEL_IMAGETYPE = "zImage"
KERNEL_DEVICETREE += "imx7d-colibri-eval-v3.dtb imx7s-colibri-eval-v3.dtb \
                      imx7d-colibri-aster.dtb imx7s-colibri-aster.dtb"

# U-Boot of our newer release read the Kernel and device tree from static UBI
# volumes, hence no need to deploy the kernel binary in the image itself
RDEPENDS_${KERNEL_PACKAGE_NAME}-base = ""

PREFERRED_PROVIDER_u-boot ?= "u-boot-toradex"
PREFERRED_PROVIDER_virtual/bootloader ?= "u-boot-toradex"
PREFERRED_PROVIDER_u-boot-fw-utils ?= "u-boot-toradex-fw-utils"
PREFERRED_RPROVIDER_u-boot-fw-utils ?= "u-boot-toradex-fw-utils"

# U-Boot NAND binary includes 0x400 padding required for NAND boot
UBOOT_BINARY = "u-boot-nand.imx"
UBOOT_MAKE_TARGET = "u-boot-nand.imx"
UBOOT_MACHINE ?= "colibri_imx7_defconfig"

IMAGE_FSTYPES += "tar.xz"
# wic support
WKS_FILE = "sdimage-bootpart.wks"

# Enable free --space-fixup (-F) by default, this allows DFU updates
MKUBIFS_ARGS = " -c 8112 -e 124KiB -m 2KiB -F"
UBINIZE_ARGS = " -p 128KiB -m 2048 -s 2048"
UBI_VOLNAME = "rootfs"

SERIAL_CONSOLES = "115200;ttymxc0"

MACHINE_FEATURES += "screen usbgadget usbhost vfat ext2 alsa touchscreen wifi bluetooth 3g"
```
