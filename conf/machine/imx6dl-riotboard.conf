## conf/machine/imx6dl-riotboard.conf
```bitbake
#@TYPE: Machine
#@NAME: RIoTboard
#@SOC: i.MX6S
#@DESCRIPTION: Machine configuration for i.MX6S RIoTboard.
#@MAINTAINER: Nikolay Dimitrov <picmaster@mail.bg>

include conf/machine/include/imx-base.inc
include conf/machine/include/tune-cortexa9.inc

MACHINEOVERRIDES =. "mx6:mx6dl:"

UBOOT_MACHINE = "riotboard_defconfig"

PREFERRED_PROVIDER_virtual/kernel ?= "linux-fslc"
KERNEL_DEVICETREE = "imx6dl-riotboard.dtb"

SERIAL_CONSOLE = "115200 ttymxc1"

MACHINE_ESSENTIAL_EXTRA_RDEPENDS += " \
    kernel-image \
    kernel-devicetree \
    u-boot-fslc \
"

WKS_FILES ?= "imx-uboot.wks"

IMAGE_DEPENDS_wic_append = " virtual/bootloader"

IMAGE_FSTYPES = "wic.gz"
```

## conf/machine/imx6q-dms-ba16.conf
```bitbake
#@TYPE: Machine
#@NAME: Advantech DMS BA16
#@SOC: i.MX6Q
#@DESCRIPTION: Machine configuration for Advantech DMS BA16 board
#@MAINTAINER: Akshay Bhat <akshay.bhat@timesys.com>

MACHINEOVERRIDES =. "mx6:mx6q:"

include conf/machine/include/imx-base.inc
include conf/machine/include/tune-cortexa9.inc

UBOOT_MACHINE = "dms-ba16_defconfig"

PREFERRED_PROVIDER_virtual/kernel = "linux-advantech"
PREFERRED_PROVIDER_kernel = "linux-advantech"
KERNEL_DEVICETREE = "imx6q-dms-ba16.dtb"
KERNEL_IMAGETYPE = "uImage"

MACHINE_FEATURES += "pci"

SERIAL_CONSOLE = "115200 ttymxc3"
```

## conf/machine/imx6q-elo.conf
```bitbake
#@TYPE: Machine
#@NAME: General Electric ELO
#@SOC: i.MX6Q
#@DESCRIPTION: Machine configuration for Advantech/GE ELO system
#@MAINTAINER: Justin Waters <justin.waters@timesys.com>

include conf/machine/include/imx-base.inc
include conf/machine/include/tune-cortexa9.inc

SOC_FAMILY = "mx6:mx6q"

PREFERRED_PROVIDER_virtual/bootloader = "u-boot-ge"
PREFERRED_PROVIDER_u-boot = "u-boot-ge"
UBOOT_MACHINE = "ge_elo_yocto_defconfig"

PREFERRED_PROVIDER_virtual/kernel = "linux-ge"
PREFERRED_PROVIDER_kernel = "linux-ge"
KERNEL_DEVICETREE = "imx6q-elo.dtb"
KERNEL_IMAGETYPE = "uImage"

MACHINE_FEATURES += "pci"

SERIAL_CONSOLE = "115200 ttymxc3"
```

## conf/machine/imx6qdl-pico.conf
```bitbake
#@TYPE: Machine
#@NAME: IMX6Q/DL-PICO
#@SOC: i.MX6QDL
#@DESCRIPTION: Machine configuration for IMX6QDL-PICO board.
#@MAINTAINER: Otavio Salvador otavio.salvador@ossystems.com.br

MACHINEOVERRIDES =. "mx6q:mx6dl:"

require conf/machine/include/imx-base.inc
require conf/machine/include/arm/armv7a/tune-cortexa9.inc

IMX_DEFAULT_BSP = "mainline"
IMX_DEFAULT_BOOTLOADER = "u-boot-fslc"

SERIAL_CONSOLES = "115200;ttymxc0"

SPL_BINARY = "SPL"
UBOOT_SUFFIX = "img"
UBOOT_MAKE_TARGET = ""

UBOOT_EXTLINUX = "1"
UBOOT_EXTLINUX_ROOT = "root=PARTUUID=${uuid}"
UBOOT_EXTLINUX_CONSOLE = "console=${console},${baudrate}"

UBOOT_CONFIG ??= "generic"
UBOOT_CONFIG[generic] = "pico-imx6_defconfig"

KERNEL_DEVICETREE = " \
    imx6dl-pico-dwarf.dtb \
    imx6dl-pico-hobbit.dtb \
    imx6dl-pico-nymph.dtb \
    imx6dl-pico-pi.dtb \
    imx6q-pico-dwarf.dtb \
    imx6q-pico-hobbit.dtb \
    imx6q-pico-nymph.dtb \
    imx6q-pico-pi.dtb \
"
MACHINE_ESSENTIAL_EXTRA_RDEPENDS += " \
    kernel-image \
    kernel-devicetree \
    u-boot-fslc \
"

MACHINE_EXTRA_RRECOMMENDS += " \
    bcm4339-nvram-config \
"

WKS_FILES ?= "imx-uboot-spl.wks.in"
WKS_FILE_DEPENDS ?= ""
IMAGE_FSTYPES = "wic.bmap wic.xz ext4.gz"

MACHINE_FIRMWARE:append = " linux-firmware-ath10k"

MACHINE_FEATURES += " pci bluetooth touchscreen wifi"
```

## conf/machine/imx6qdl-variscite-som.conf
```bitbake
#@TYPE: Machine
#@NAME: Variscite i.MX6Q/DL VAR-SOM-MX6
#@SOC: i.MX6Q/DL
#@DESCRIPTION: Machine configuration for Variscite i.MX6Q/DL VAR-SOM-MX6
#@MAINTAINER: Fabio Berton <fabio.berton@ossystems.com.br>

MACHINEOVERRIDES =. "mx6:mx6q:mx6dl:"

require conf/machine/include/imx-base.inc
require conf/machine/include/tune-cortexa9.inc

PREFERRED_PROVIDER_virtual/kernel = "linux-variscite"

KERNEL_DEVICETREE = " \
    imx6dl-var-som-cap.dtb \
    imx6dl-var-som-res.dtb \
    imx6dl-var-som-vsc.dtb \
    imx6dl-var-som-solo-cap.dtb \
    imx6dl-var-som-solo-res.dtb \
    imx6dl-var-som-solo-vsc.dtb \
    imx6q-var-som-cap.dtb \
    imx6q-var-som-res.dtb \
    imx6q-var-som-vsc.dtb \
"

KERNEL_IMAGETYPE = "uImage"

UBOOT_SPL_BUILD = "yes"
UBOOT_MAKE_TARGET = "all"
UBOOT_SUFFIX = "img"

PREFERRED_PROVIDER_virtual/bootloader = "u-boot-variscite"
PREFERRED_PROVIDER_u-boot = "u-boot-variscite"

UBOOT_CONFIG ??= "nand sd"
UBOOT_CONFIG[sd] = "mx6var_som_sd_config,sdcard"
UBOOT_CONFIG[nand] = "mx6var_som_nand_config,ubifs"

SPL_BINARY = "SPL"

## NAND 512MB
UBI_ROOT_FS_NAME = "[rootfs]"
UBI_VOLNAME  = "rootfs"
MKUBIFS_ARGS = " -m 2048 -e 124KiB -c 3965 -F "
UBINIZE_ARGS = " -m 2048 -p 128KiB -s 2048 -O 2048 "

SERIAL_CONSOLE = "115200 ttymxc0"

USE_VT = "0"

MACHINE_FIRMWARE_append = " linux-firmware-wl12xx linux-firmware-wl18xx"

MACHINE_FEATURES += " pci bluetooth touchscreen wifi"
```

## conf/machine/imx6qsabrelite.conf
```bitbake
#@TYPE: Machine
#@NAME: Boundary Devices i.MX6Q SABRE Lite
#@SOC: i.MX6Q
#@DESCRIPTION: Machine configuration for Boundary Devices i.MX6Q SABRE Lite
#@MAINTAINER: Eric Nelson <eric.nelson@boundarydevices.com>

# WARNING: This board now use the *same* code as Nitrogen6X and it
#          boots from internal SPI NOR memory. If you did change it to boot
#          from the MMC (SD3 or SD4) please check the Boundary's blog post
#          at: http://boundarydevices.com/u-boot-on-i-mx6/#unbricking

MACHINEOVERRIDES = "nitrogen6x:${MACHINE}"
include conf/machine/nitrogen6x.conf
```

## conf/machine/imx6sl-warp.conf
```bitbake
#@TYPE: Machine
#@NAME: WaRP
#@SOC: i.MX6SL
#@DESCRIPTION: Machine configuration for i.MX6SL WaRP board.
#@MAINTAINER: Otavio Salvador <otavio@ossystems.com.br>

#Warp has an eMMC that stores the bootloader, kernel, dtb and rootfs.
#An easy way to flash the generated  <image>.sdcard image is
#following these steps:
#
# 1.Connect the serial to USB adapter from Warp to the host PC
# 2.Connect the USB OTG Warp port to the host PC
#   (Warp can be powered via USB OTG port).
# 3.In the U-boot prompt type:
#   => ums 0 mmc 0
# 4.Then the Warp eMMC will be mounted as a USB gadget in the host PC
# 5.On the host PC, copy the generated .sdcard image into Warp's eMMC:
#   $ umount /dev/<ums-device>
#   $ sudo dd if=<image>.sdcard of=/dev/<ums-device>
#
#WARNING: Double check by running dmesg on the host PC which is the
#correct node that corresponds to the Warp board. Passing an incorrect
#device number may overwrite the host PC file system, causing boot issues there.

include conf/machine/include/imx-base.inc
include conf/machine/include/tune-cortexa9.inc

# WaRP uses eMMC boot partition by default and the u-boot inside .sdcard image
# does not override it. However, build u-boot binary anyway in order to provide
# a binary to be used if an update is needed
# see how-to override eMMC boot partition on the following link
# http://git.denx.de/?p=u-boot.git;a=blob;f=board/warp/README
IMAGE_BOOTLOADER ?= ""
EXTRA_IMAGEDEPENDS += "u-boot"

UBOOT_MACHINE ?= "warp_defconfig"

PREFERRED_PROVIDER_virtual/kernel ?= "linux-fslc"
KERNEL_DEVICETREE = "imx6sl-warp.dtb"

SERIAL_CONSOLE = "115200 ttymxc0"

MACHINE_FEATURES += "wifi bluetooth serial"
MACHINE_EXTRA_RRECOMMENDS += "bcm4330-nvram-config"
```

## conf/machine/imx6ul-kontron.conf
```bitbake
#@TYPE: Machine
#@NAME: Kontron N63XX/N64XX SoM based boards
#@SOC: i.MX6UL/i.MX6ULL
#@DESCRIPTION: Machine configuration for Kontron N63XX/N64XX SoM based boards
#@MAINTAINER: Frieder Schrempf <frieder.schrempf@kontron.de>

MACHINEOVERRIDES =. "mx6ul:"

include conf/machine/include/imx-base.inc
include conf/machine/include/arm/armv7a/tune-cortexa7.inc

IMX_DEFAULT_BSP = "mainline"

PREFERRED_PROVIDER_virtual/kernel ?= "linux-kontron"
PREFERRED_PROVIDER_u-boot ?= "u-boot-kontron"
PREFERRED_PROVIDER_virtual/bootloader ?= "u-boot-kontron"

KERNEL_CLASSES ?= " kernel-fitimage "
KERNEL_IMAGETYPES ?= "fitImage"
KERNEL_DEVICETREE = " \
	imx6ul-kontron-n6310-s.dtb \
	imx6ul-kontron-n6310-s-43.dtb \
	imx6ul-kontron-n6311-s.dtb \
	imx6ull-kontron-n6411-s.dtb \
"


SERIAL_CONSOLES = "115200;ttymxc3"

UBOOT_CONFIG = "kontron-mx6ul"
UBOOT_CONFIG[kontron-mx6ul] = "kontron_mx6ul_defconfig"

SPL_BINARY = "SPL"
UBOOT_ENTRYPOINT = "0x81000000"
UBOOT_MAKE_TARGET = "u-boot.img SPL"
UBOOT_SUFFIX = "img"

UBOOT_EXTLINUX ?= "1"
UBOOT_EXTLINUX_LABELS ?= "default"
UBOOT_EXTLINUX_KERNEL_IMAGE ?= "../fitImage"
UBOOT_EXTLINUX_FDTDIR ?= ""
UBOOT_EXTLINUX_KERNEL_ARGS ?= "rootwait"
UBOOT_EXTLINUX_TIMEOUT = "8"
UBOOT_EXTLINUX_LABELS = "kontron-n6310-s kontron-n6311-s kontron-n6310-s-43 kontron-n6411-s"
UBOOT_EXTLINUX_KERNEL_IMAGE_kontron-n6310-s = "../fitImage#conf@imx6ul-kontron-n6310-s.dtb"
UBOOT_EXTLINUX_KERNEL_IMAGE_kontron-n6311-s = "../fitImage#conf@imx6ul-kontron-n6311-s.dtb"
UBOOT_EXTLINUX_KERNEL_IMAGE_kontron-n6310-s-43 = "../fitImage#conf@imx6ul-kontron-n6310-s-43.dtb"
UBOOT_EXTLINUX_KERNEL_IMAGE_kontron-n6411-s = "../fitImage#conf@imx6ull-kontron-n6411-s.dtb"
UBOOT_EXTLINUX_MENU_DESCRIPTION_kontron-n6310-s = "Kontron N6310 S"
UBOOT_EXTLINUX_MENU_DESCRIPTION_kontron-n6311-s = "Kontron N6311 S"
UBOOT_EXTLINUX_MENU_DESCRIPTION_kontron-n6310-s-43 = "Kontron N6310 S 43"
UBOOT_EXTLINUX_MENU_DESCRIPTION_kontron-n6411-s = "Kontron N6411 S"
UBOOT_EXTLINUX_CONSOLE = "console=ttymxc3,115200"
UBOOT_EXTLINUX_ROOT = "root=/dev/mmcblk0p2"

MACHINE_FEATURES = "usbhost vfat serial ext2 rtc usbgadget"
IMAGE_BOOT_FILES = " \
    extlinux.conf;extlinux/extlinux.conf \
    fitImage \
"

WKS_FILES ?= "imx-uboot-spl-bootpart.wks.in"
```

## conf/machine/imx6ul-pico-hobbit.conf
```bitbake
#@TYPE: Machine
#@NAME: Hobbitboard (PICO-IMX6UL) 
#@SOC: i.MX6UL
#@DESCRIPTION: Machine configuration for Hobbitboard (PICO-IMX6UL)
#@MAINTAINER: Daiane Angolini <daiane.angolini@nxp.com>

MACHINEOVERRIDES =. "mx6:mx6ul:"

include conf/machine/include/imx-base.inc
include conf/machine/include/tune-cortexa7.inc

MACHINE_FEATURES += "wifi bluetooth"

SERIAL_CONSOLE = "115200 ttymxc5"

PREFERRED_PROVIDER_virtual/kernel ?= "linux-fslc"
KERNEL_DEVICETREE = "imx6ul-pico-hobbit.dtb"

UBOOT_CONFIG ??= "sd"
UBOOT_CONFIG[sd] = "pico-imx6ul_config,sdcard"
```

## conf/machine/imx6ul-pico.conf
```bitbake
#@TYPE: Machine
#@NAME: IMX6UL-PICO
#@SOC: i.MX6UL
#@DESCRIPTION: Machine configuration for IMX6UL-PICO board.
#@MAINTAINER: Daiane Angolini <daiane.angolini@nxp.com>

MACHINEOVERRIDES =. "mx6ul:"

include conf/machine/include/imx-base.inc
include conf/machine/include/arm/armv7a/tune-cortexa7.inc

IMX_DEFAULT_BSP = "mainline"
IMX_DEFAULT_BOOTLOADER = "u-boot-fslc"

SERIAL_CONSOLES = "115200;ttymxc5"

KERNEL_DEVICETREE = " \
    imx6ul-pico-dwarf.dtb \
    imx6ul-pico-hobbit.dtb \
    imx6ul-pico-pi.dtb \
"

SPL_BINARY = "SPL"
UBOOT_SUFFIX = "img"
UBOOT_MAKE_TARGET = ""

UBOOT_CONFIG ??= "dwarf hobbit pi generic"
UBOOT_CONFIG[dwarf] = "pico-dwarf-imx6ul_defconfig"
UBOOT_CONFIG[generic] = "pico-imx6ul_defconfig"
UBOOT_CONFIG[hobbit] = "pico-hobbit-imx6ul_defconfig"
UBOOT_CONFIG[pi] = "pico-pi-imx6ul_defconfig"

UBOOT_EXTLINUX = "1"
UBOOT_EXTLINUX_ROOT = "root=PARTUUID=${uuid}"
UBOOT_EXTLINUX_CONSOLE = "console=${console},${baudrate}"

MACHINE_ESSENTIAL_EXTRA_RDEPENDS += " \
    kernel-image \
    kernel-devicetree \
    u-boot-fslc \
"

MACHINE_FEATURES += "wifi bluetooth"

WKS_FILES ?= "imx-uboot-spl.wks.in"
WKS_FILE_DEPENDS ?= ""
IMAGE_FSTYPES = "wic.bmap wic.xz ext4.gz"
```

## conf/machine/imx7d-pico.conf
```bitbake
#@TYPE: Machine
#@NAME: IMX7D-PICO
#@SOC: i.MX7D
#@DESCRIPTION: Machine configuration for IMX7D-PICO board.
#@MAINTAINER: Vanessa Maegima <vanessa.maegima@nxp.com>

MACHINEOVERRIDES =. "mx7:mx7d:"

require conf/machine/include/imx-base.inc
require conf/machine/include/arm/armv7a/tune-cortexa7.inc

IMX_DEFAULT_BSP = "mainline"
IMX_DEFAULT_BOOTLOADER = "u-boot-fslc"

SERIAL_CONSOLES = "115200;ttymxc4"

KERNEL_DEVICETREE = " \
    imx7d-pico-dwarf.dtb \
    imx7d-pico-hobbit.dtb \
    imx7d-pico-pi.dtb \
"

SPL_BINARY = "SPL"
UBOOT_BINARY = "u-boot-dtb.img"
UBOOT_SUFFIX = "img"
UBOOT_MAKE_TARGET = ""

UBOOT_CONFIG ??= "dwarf hobbit nymph pi generic"
UBOOT_CONFIG[dwarf] = "pico-dwarf-imx7d_defconfig"
UBOOT_CONFIG[generic] = "pico-imx7d_defconfig"
UBOOT_CONFIG[hobbit] = "pico-hobbit-imx7d_defconfig"
UBOOT_CONFIG[nymph] = "pico-nymph-imx7d_defconfig"
UBOOT_CONFIG[pi] = "pico-pi-imx7d_defconfig"

UBOOT_EXTLINUX = "1"
UBOOT_EXTLINUX_ROOT = "root=PARTUUID=${uuid}"
UBOOT_EXTLINUX_CONSOLE = "console=${console},${baudrate}"

MACHINE_ESSENTIAL_EXTRA_RDEPENDS += " \
    kernel-image \
    kernel-devicetree \
    u-boot-fslc \
"

MACHINE_EXTRA_RRECOMMENDS += " \
  bcm4339-nvram-config \
  linux-firmware-ath10k \
"

WKS_FILES ?= "imx-uboot-spl.wks.in"
WKS_FILE_DEPENDS ?= ""
IMAGE_FSTYPES = "wic.bmap wic.xz ext4.gz"
```

## conf/machine/imx7d-remarkable2.conf
```bitbake
#@TYPE: Machine
#@NAME: IMX7D-reMarkable2
#@SOC: i.MX7D
#@DESCRIPTION: Machine configuration for reMarkble2 E-Ink Tablet.
#@MAINTAINER: Alistair Francis <alistair@alistair23.me>

MACHINEOVERRIDES =. "mx7:mx7d:"

require conf/machine/include/imx-base.inc
require conf/machine/include/arm/armv7a/tune-cortexa7.inc

IMX_DEFAULT_BSP = "mainline"
SERIAL_CONSOLES = "115200;ttymxc5"

PREFERRED_PROVIDER_virtual/kernel ?= "linux-remarkable2"
KERNEL_DEVICETREE = "imx7d-remarkable2.dtb"
KBUILD_DEFCONFIG = "imx_v6_v7_defconfig"

PREFERRED_PROVIDER_virtual/bootloader ?= "u-boot-remarkable2"
UBOOT_MACHINE ?= "zero-sugar_defconfig"
UBOOT_BINARY = "u-boot-dtb.imx"
UBOOT_MAKE_TARGET = ""

MACHINE_ESSENTIAL_EXTRA_RDEPENDS += " \
    kernel-image \
    kernel-devicetree \
    u-boot-remarkable2 \
"

# The Linux kernel expects firmware for bcm43456,
# but there isn't yet support upstream for bcm43456 so we also
# include bcm43455 as a fallback.
MACHINE_EXTRA_RRECOMMENDS += " \
  linux-firmware-imx-sdma-imx7d \
  linux-firmware-bcm43455 \
  linux-firmware-bcm43456 \
  wpa-supplicant \
"

IMAGE_FSTYPES = "ext4.gz ext4.gz.u-boot"
```

## conf/machine/imx7s-warp.conf
```bitbake
#@TYPE: Machine
#@NAME: WaRP7
#@SOC: i.MX7S
#@DESCRIPTION: Machine configuration for i.MX7S WaRP board.
#@MAINTAINER: Pierre-Jean Texier <texier.pj2@gmail.com>

MACHINEOVERRIDES =. "mx7:mx7d:"

require conf/machine/include/imx-base.inc
require conf/machine/include/arm/armv7a/tune-cortexa7.inc

IMX_DEFAULT_BSP = "mainline"

MACHINE_FEATURES += " wifi bluetooth"

KERNEL_DEVICETREE = "imx7s-warp.dtb"

UBOOT_BINARY = "u-boot-dtb.imx"
UBOOT_SUFFIX = "imx"
UBOOT_MAKE_TARGET = ""

UBOOT_CONFIG ??= "sd"
UBOOT_CONFIG[sd] = "warp7_defconfig,sdcard"

MACHINE_EXTRA_RRECOMMENDS += "bcm43430-nvram-config"
```
