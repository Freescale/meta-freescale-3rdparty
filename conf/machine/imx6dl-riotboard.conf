## conf/machine/include/ccimx6ulsom.inc
```bitbake
#@TYPE: Machine
#@NAME: ConnecCore 6UL SOM
#@SOC: i.MX6UL
#@DESCRIPTION: Machine configuration for ConnectCore 6UL System-On-Module.
#@MAINTAINER: Alex Gonzalez <alex.gonzalez@digi.com>

MACHINEOVERRIDES =. "mx6:mx6ul:ccimx6ul:use-mainline-bsp:"

include conf/machine/include/imx-base.inc
include conf/machine/include/tune-cortexa7.inc

PREFERRED_PROVIDER_virtual/bootloader = "u-boot-digi"
PREFERRED_PROVIDER_u-boot = "u-boot-digi"

UBOOT_BOOTSCRIPT = "boot.scr"

UBOOT_CONFIG ??= "ccimx6ulstarter1GB ccimx6ulstarter"
UBOOT_CONFIG[ccimx6ulstarter1GB] = "ccimx6ulstarter1GB_defconfig"
UBOOT_CONFIG[ccimx6ulstarter] = "ccimx6ulstarter_defconfig"

MACHINE_EXTRA_RDEPENDS += " \
    mtd-utils-ubifs \
"

MACHINE_FEATURES += " wifi bluetooth"

MACHINE_EXTRA_RRECOMMENDS += " \
    ${@bb.utils.contains('MACHINE_FEATURES', 'wifi', 'kernel-module-qca6564 linux-firmware-qca6564-wifi', '', d)} \
    ${@bb.utils.contains('MACHINE_FEATURES', 'bluetooth', 'linux-firmware-qca6564-bt', '', d)} \
"

# mkfs.ubifs parameters for boot partition (the one holding kernel and device tree files)
# Max LEB count (-c 255) calculated for a partition of up to 32 MiB considering 128 KiB erase-block size.
MKUBIFS_BOOT_ARGS ?= "-m 2048 -e 126976 -c 255"

# mkfs.ubifs parameters for rootfs partition
# Max LEB count (-c 8191) calculated for a partition of up to 1 GiB considering 128 KiB erase-block size.
MKUBIFS_ARGS ?= "-m 2048 -e 126976 -c 8191"

IMAGE_CLASSES += "image_types_digi"
# Overwrite the defaults in imx-base not to include wic images
IMAGE_FSTYPES = "tar.bz2 ubifs boot.ubifs"
```

## conf/machine/include/cfa10036.inc
```bitbake
# Common definitions for cfa-10036 boards

MACHINEOVERRIDES =. "mxs:mx28:cfa10036:"

include conf/machine/include/imx-base.inc
include conf/machine/include/tune-arm926ejs.inc

PREFERRED_PROVIDER_virtual/kernel ?= "linux-cfa"
PREFERRED_PROVIDER_virtual/bootloader ?= "barebox"

IMAGE_BOOTLOADER = "barebox"
BAREBOX_BINARY = "barebox"
IMAGE_FSTYPES_mxs = "tar.bz2 barebox.mxsboot-sdcard sdcard.gz"

IMXBOOTLETS_MACHINE = "cfa10036"

KERNEL_IMAGETYPE = "zImage"
KERNEL_DEVICETREE = "imx28-cfa10036.dtb"

# we need the kernel to be installed in the final image
IMAGE_INSTALL_append = " kernel-image kernel-devicetree"

SDCARD_ROOTFS ?= "${DEPLOY_DIR_IMAGE}/${IMAGE_NAME}.rootfs.ext3"

SERIAL_CONSOLE = "115200 ttyAMA0"

MACHINE_FEATURES = "usbgadget usbhost vfat"

# Overrides due use of non-FSL kernel
PREFERRED_VERSION_imx-test = "00.00.00"
MACHINE_GSTREAMER_PLUGIN_cfa10036 = ""
```

## conf/machine/include/imx233-olinuxino.inc
```bitbake
# Common definitions to all iMX233-OlinuXino variants

# Add a override for all iMX233-OLinuXino variants
MACHINEOVERRIDES =. "mxs:mx23:imx233-olinuxino:"

include conf/machine/include/imx-base.inc
include conf/machine/include/arm/armv5/tune-arm926ejs.inc

# This machine is not supported by u-boot-imx as it is not tested by NXP on this
# board. So we force it to use u-boot-fslc which is based on mainline here.
IMX_DEFAULT_BOOTLOADER = "u-boot-fslc"

UBOOT_MAKE_TARGET = "u-boot.sb"
UBOOT_SUFFIX = "sb"

IMXBOOTLETS_MACHINE = "stmp378x_dev"
UBOOT_MACHINE = "mx23_olinuxino_config"

KERNEL_IMAGETYPE = "uImage"
KERNEL_DEVICETREE = "nxp/mxs/imx23-olinuxino.dtb"

MACHINE_FEATURES = "usbgadget usbhost vfat"
```

## conf/machine/include/tx6-karo-common.inc
```bitbake
# Provides the Ka-Ro TX6 common settings

require conf/machine/include/imx-base.inc
require conf/machine/include/tune-cortexa9.inc

SERIAL_CONSOLE = "115200 ttymxc0"

UBOOT_SUFFIX = "bin"
UBOOT_MAKE_TARGET = "u-boot.bin"
UBOOT_BINARY="u-boot.bin"

PREFERRED_PROVIDER_u-boot = "u-boot-karo"
PREFERRED_PROVIDER_virtual/kernel = "linux-karo"
PREFERRED_VERSION_linux-karo ?= "3.16%"

MACHINE_FIRMWARE_append_mx6 = " linux-firmware-ath6k"
MACHINE_FEATURES += " pci wifi bluetooth"
IMAGE_FSTYPES_remove = "sdcard"
```

## conf/machine/include/wandboard.inc
```bitbake
# Common settings for wandboard boards

include conf/machine/include/imx-base.inc
include conf/machine/include/tune-cortexa9.inc

PREFERRED_PROVIDER_virtual/kernel ?= "linux-wandboard"
PREFERRED_VERSION_linux-wandboard ?= "3.10.17"

SERIAL_CONSOLE = "115200 ttymxc0"

MACHINE_FEATURES += "pci touchscreen"

KERNEL_IMAGETYPE = "zImage"
```

## conf/machine/lx2160acex7.conf
```bitbake
#@TYPE: Machine
#@NAME: Solid-Run LX2160A-CEx7
#@SOC: LSCH3
#@DESCRIPTION: Machine configuration for running LX2160A-CEx7 in 64-bit mode

require conf/machine/include/qoriq-arm64.inc
require conf/machine/include/arm/arch-arm64.inc

MACHINEOVERRIDES =. "fsl-lsch3:lx2160a:"

MACHINE_FEATURES += "optee"

KERNEL_CLASSES  = " kernel-fitimage "
KERNEL_IMAGETYPES = "fitImage"

DTB_LOAD = "0x90000000"
UBOOT_ENTRYPOINT = "0x80080000"

UBOOT_CONFIG ??= "tfa"
UBOOT_CONFIG[tfa] = "lx2160acex7_tfa_defconfig,,u-boot-dtb.bin"

KERNEL_DEVICETREE_BASENAME ?= "fsl-lx2160a-cex7.dtb"
KERNEL_DEVICETREE ?= "freescale/${KERNEL_DEVICETREE_BASENAME}"
KERNEL_DEFCONFIG ?= "defconfig"

SERIAL_CONSOLES ?= "115200;ttyS0 115200;ttyS1 115200;ttyAMA0"
SERIAL_CONSOLES_CHECK ?= "${SERIAL_CONSOLES}"

#SERDES=8_5_2 # 8x10g
#SERDES=13_5_2 # dual 100g
#SERDES=20_5_2 # dual 40g
SERDES ?= "8_5_2"
SPEED ?= "2000_700_3200"

RCWAUTO ?= "${SERDES}/${SPEED}"
BOOTTYPE="auto"

EXTRA_IMAGEDEPENDS += "management-complex mc-utils rcw ls2-phy ddr-phy qoriq-atf inphi"
USE_VT = "0"

PREFERRED_PROVIDER_u-boot-default-script = "u-boot-script-qoriq"
PREFERRED_PROVIDER_virtual/kernel = "linux-fslc-qoriq"
PREFERRED_VERSION_linux-qoriq = "5.4%"
PREFERRED_VERSION_u-boot-qoriq = "2019.10%"
PREFERRED_VERSION_qoriq-atf = "1.5%"

IMAGE_FSTYPES += "wic"
WKS_FILE = "lx2160acex7.wks.in"
WKS_FILE_DEPENDS:append = "\
    ${PREFERRED_PROVIDER_u-boot-default-script} \
"
IMAGE_BOOT_FILES ?= "${KERNEL_IMAGETYPE} ${KERNEL_DEVICETREE_BASENAME} boot.scr-${MACHINE};boot.scr"
```

## conf/machine/m28evk.conf
```bitbake
#@TYPE: Machine
#@NAME: DENX M28 SoM Evaluation Kit
#@SOC: i.MX28
#@DESCRIPTION: Machine configuration for DENX M28 SoM Evaluation Kit

include conf/machine/include/mxs-base.inc

SOC_FAMILY = "mxs:mx28"

UBOOT_MACHINE = "m28evk_config"

PREFERRED_PROVIDER_virtual/kernel ?= "linux-fslc"
KERNEL_IMAGETYPE = "uImage"
KERNEL_DEVICETREE = "imx28-m28evk.dtb"

SDCARD_ROOTFS ?= "${DEPLOY_DIR_IMAGE}/${IMAGE_NAME}.rootfs.ext3"
IMAGE_FSTYPES ?= "tar.bz2 ext3 uboot.mxsboot-sdcard sdcard"

SERIAL_CONSOLE = "115200 ttyAMA0"

MACHINE_FEATURES = "apm usbgadget usbhost vfat alsa touchscreen"

# Overrides due use of non-FSL kernel
PREFERRED_VERSION_imx-test = "00.00.00"
MACHINE_GSTREAMER_PLUGIN_m28evk = ""
```

## conf/machine/m53evk.conf
```bitbake
#@TYPE: Machine
#@NAME: DENX M53 SoM Evaluation Kit
#@SOC: i.MX53
#@DESCRIPTION: Machine configuration for DENX M53 SoM Evaluation Kit

include conf/machine/include/imx-base.inc
include conf/machine/include/tune-cortexa8.inc

SOC_FAMILY = "mx5:mx53"

UBOOT_MACHINE = "m53evk_config"

PREFERRED_PROVIDER_virtual/kernel ?= "linux-denx"

KERNEL_IMAGETYPE = "uImage"
KERNEL_DEVICETREE = "imx53-m53evk.dtb"

SDCARD_ROOTFS ?= "${DEPLOY_DIR_IMAGE}/${IMAGE_NAME}.rootfs.ext3"
IMAGE_FSTYPES ?= "tar.bz2 ext3 sdcard"

SERIAL_CONSOLE = "115200 ttymxc1"

MACHINE_FEATURES = "apm usbgadget usbhost vfat alsa touchscreen"

# Overrides due use of non-FSL kernel
PREFERRED_VERSION_imx-test = "00.00.00"
MACHINE_GSTREAMER_PLUGIN_m53evk = ""
XSERVER_DRIVER_m53evk = "xf86-video-fbdev"
```

## conf/machine/nitrogen6sx.conf
```bitbake
#@TYPE: Machine
#@NAME: Boundary Devices Nitrogen6SX
#@SOC: i.MX6SX
#@DESCRIPTION: Machine configuration for Boundary Devices Nitrogen6SX
#@MAINTAINER: Chris Dimich <chris.dimich@boundarydevices.com>

MACHINEOVERRIDES =. "mx6sx:"

IMX_DEFAULT_BSP ?= "nxp"

include conf/machine/include/imx-base.inc
include conf/machine/include/arm/armv7a/tune-cortexa9.inc

KERNEL_DEVICETREE = "imx6sx-nitrogen6sx.dtb"
KERNEL_IMAGETYPE = "zImage"

IMX_DEFAULT_BOOTLOADER = "u-boot-boundary"
UBOOT_SUFFIX = "imx"
UBOOT_BINARY = "u-boot.${UBOOT_SUFFIX}"
PREFERRED_PROVIDER_virtual/kernel ??= "linux-boundary"
PREFERRED_PROVIDER_virtual/kernel:use-mainline-bsp ??= "linux-fslc"

# wic support
WKS_FILE = "sdimage-bootpart.wks"
IMAGE_BOOT_FILES:append = " \
    boot.scr-${MACHINE};boot.scr \
"
WKS_FILE_DEPENDS += " u-boot-script-boundary"

UBOOT_MACHINE ?= "nitrogen6sx_defconfig"

SERIAL_CONSOLES = "115200;ttymxc0"

MACHINE_EXTRA_RRECOMMENDS += "linux-firmware-wl12xx"
MACHINE_FEATURES += " pci wifi bluetooth"
```

## conf/machine/nitrogen6x-lite.conf
```bitbake
#@TYPE: Machine
#@NAME: Boundary Devices Nitrogen6X Lite
#@SOC: i.MX6S
#@DESCRIPTION: Machine configuration for Boundary Devices Nitrogen6X Lite
#@MAINTAINER: Chris Dimich <chris.dimich@boundarydevices.com>

MACHINEOVERRIDES =. "mx6:mx6dl:"

include conf/machine/include/imx-base.inc
include conf/machine/include/tune-cortexa9.inc

KERNEL_DEVICETREE = "imx6dl-nit6xlite.dtb"
KERNEL_IMAGETYPE = "zImage"

PREFERRED_PROVIDER_u-boot ??= "u-boot-boundary"
PREFERRED_PROVIDER_virtual/bootloader ??= "u-boot-boundary"
PREFERRED_PROVIDER_virtual/kernel ??= "linux-boundary"
PREFERRED_PROVIDER_virtual/kernel_use-mainline-bsp ??= "linux-fslc"

# wic support
WKS_FILE = "sdimage-bootpart.wks"
IMAGE_BOOT_FILES_append = " \
    boot.scr-${MACHINE};boot.scr \
"
WKS_FILE_DEPENDS = " \
    u-boot-script-boundary \
    \
    e2fsprogs-native \
    bmap-tools-native \
"

UBOOT_MACHINE ?= "nit6xlite_defconfig"

SERIAL_CONSOLES = "115200;ttymxc1"

MACHINE_EXTRA_RRECOMMENDS += " bcm4330-nvram-config"
MACHINE_FEATURES += " pci wifi bluetooth"
```

## conf/machine/nitrogen6x.conf
```bitbake
#@TYPE: Machine
#@NAME: Boundary Devices Nitrogen6X
#@SOC: i.MX6 Q/DL
#@DESCRIPTION: Machine configuration for Boundary Devices Nitrogen6X
#@MAINTAINER: Chris Dimich <chris.dimich@boundarydevices.com>
#
# Note that this machine configuration also supports the SABRE Lite
# reference design and the Nitrogen6X-SOM.
#
# By default, this machine will build for the standard Quad-Core, 1GB
# option.
#
# To build U-Boot for other CPU or memory combinations, you can set
# the UBOOT_MACHINE variable in your local.conf according to the
# following table:
#
# Processor           Memory    Configuration
# --------------      ------    --------------------
# i.MX6Quad/Dual        1GB     nitrogen6q_config
# i.MX6Quad/Dual        2GB     nitrogen6q2g_config
# i.MX6Quad/Dual        4GB     nitrogen6_max_config
# i.MX6Dual-Lite        1GB     nitrogen6dl_config
# i.MX6Dual-Lite        2GB     nitrogen6dl2g_config
# i.MX6Solo           512MB     nitrogen6s_config
# i.MX6Solo             1GB     nitrogen6s1g_config
#
# See this blog post for details:
#    http://boundarydevices.com/u-boot-updates-for-i-mx6-single
#
#

MACHINEOVERRIDES =. "mx6:mx6dl:mx6q:"

include conf/machine/include/imx-base.inc
include conf/machine/include/tune-cortexa9.inc

KERNEL_DEVICETREE = "imx6q-sabrelite.dtb \
                        imx6q-nitrogen6_max.dtb imx6qp-nitrogen6_max.dtb \
                        imx6q-nitrogen6x.dtb imx6dl-nitrogen6x.dtb \
                        imx6q-nitrogen6_som2.dtb imx6qp-nitrogen6_som2.dtb \
                        imx6dl-nitrogen6_vm.dtb imx6dl-nitrogen6_vm-magstripe.dtb \
"

# Not yet supported by Linux mainline
KERNEL_DEVICETREE_remove_use-mainline-bsp = "imx6dl-nitrogen6_vm.dtb imx6dl-nitrogen6_vm-magstripe.dtb"

KERNEL_IMAGETYPE = "zImage"

PREFERRED_PROVIDER_u-boot ??= "u-boot-boundary"
PREFERRED_PROVIDER_virtual/bootloader ??= "u-boot-boundary"
PREFERRED_PROVIDER_virtual/kernel ??= "linux-boundary"
PREFERRED_PROVIDER_virtual/kernel_use-mainline-bsp ??= "linux-fslc"

# wic support
WKS_FILE = "sdimage-bootpart.wks"
IMAGE_BOOT_FILES_append = " \
    boot.scr-${MACHINE};boot.scr \
"
WKS_FILE_DEPENDS = " \
    u-boot-script-boundary \
    \
    e2fsprogs-native \
    bmap-tools-native \
"

UBOOT_MACHINE ?= "nitrogen6q_defconfig"

SERIAL_CONSOLES = "115200;ttymxc1"

MACHINE_EXTRA_RRECOMMENDS += "linux-firmware-wl12xx"
MACHINE_ESSENTIAL_EXTRA_RDEPENDS += " \
    kernel-image \
    kernel-devicetree \
"

MACHINE_FEATURES += " pci wifi bluetooth"
```

## conf/machine/nitrogen7.conf
```bitbake
#@TYPE: Machine
#@NAME: Boundary Devices Nitrogen7
#@SOC: i.MX7D
#@DESCRIPTION: Machine configuration for Boundary Devices Nitrogen7
#@MAINTAINER: Chris Dimich <chris.dimich@boundarydevices.com>

MACHINEOVERRIDES =. "mx7:mx7d:"

require conf/machine/include/imx-base.inc
require conf/machine/include/tune-cortexa7.inc

KERNEL_DEVICETREE = "imx7d-nitrogen7.dtb"
KERNEL_IMAGETYPE = "zImage"

PREFERRED_PROVIDER_u-boot ??= "u-boot-boundary"
PREFERRED_PROVIDER_virtual/bootloader ??= "u-boot-boundary"
PREFERRED_PROVIDER_virtual/kernel ??= "linux-boundary"
PREFERRED_PROVIDER_virtual/kernel_use-mainline-bsp ??= "linux-fslc"

# wic support
WKS_FILE = "sdimage-bootpart.wks"
IMAGE_BOOT_FILES_append = " \
    boot.scr-${MACHINE};boot.scr \
"
WKS_FILE_DEPENDS = " \
    u-boot-script-boundary \
    \
    e2fsprogs-native \
    bmap-tools-native \
"

UBOOT_MACHINE ?= "nitrogen7_defconfig"

SERIAL_CONSOLES = "115200;ttymxc0"

MACHINE_EXTRA_RRECOMMENDS += "linux-firmware-wl12xx"
MACHINE_FEATURES += " pci wifi bluetooth"
```
