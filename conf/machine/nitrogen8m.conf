## conf/machine/nitrogen8m.conf
```bitbake
#@TYPE: Machine
#@NAME: Boundary Devices Nitrogen8M
#@SOC: i.MX8 MQ
#@DESCRIPTION: Machine configuration for Boundary Devices Nitrogen8M
#@MAINTAINER: Chris Dimich <chris.dimich@boundarydevices.com>

MACHINEOVERRIDES =. "mx8mq:"

IMX_DEFAULT_BSP ?= "nxp"

require conf/machine/include/imx-base.inc
require conf/machine/include/arm/armv8a/tune-cortexa53.inc

# Kernel configuration
PREFERRED_PROVIDER_virtual/kernel ??= "linux-boundary"
KERNEL_DEVICETREE = "freescale/imx8mq-nitrogen8m.dtb \
	freescale/imx8mq-nitrogen8m-m4.dtb \
	freescale/imx8mq-nitrogen8m_som.dtb \
	freescale/imx8mq-nitrogen8m_som-m4.dtb \
	freescale/imx8mq-nitrogen8m-tc358743.dtb \
	freescale/imx8mq-nitrogen8m-edp.dtb \
"
KERNEL_IMAGETYPE = "Image"
RRECOMMENDS:${KERNEL_PACKAGE_NAME}-base = ""

# U-Boot configuration
IMX_DEFAULT_BOOTLOADER:imx-nxp-bsp = "u-boot-boundary"
PREFERRED_PROVIDER_u-boot ??= "u-boot-boundary"
PREFERRED_PROVIDER_virtual/bootloader ??= "u-boot-boundary"
PREFERRED_PROVIDER_imx-atf ??= "imx-atf-boundary"
SPL_BINARY = "spl/u-boot-spl.bin"
UBOOT_SUFFIX = "bin"

UBOOT_CONFIG ??= "2g 2gr0 4g som_2g som_2gr0 som_4g som_sd_2g som_sd_4g"
UBOOT_CONFIG[2g]       = "${MACHINE}_2g_defconfig,sdcard"
UBOOT_CONFIG[2gr0]       = "${MACHINE}_2gr0_defconfig,sdcard"
UBOOT_CONFIG[4g]     = "${MACHINE}_4g_defconfig,sdcard"
UBOOT_CONFIG[som_2g] = "${MACHINE}_som_2g_defconfig,sdcard"
UBOOT_CONFIG[som_2gr0]   = "${MACHINE}_som_2gr0_defconfig,sdcard"
UBOOT_CONFIG[som_4g]   = "${MACHINE}_som_4g_defconfig,sdcard"
UBOOT_CONFIG[som_sd_2g]   = "${MACHINE}_som_sd_2g_defconfig,sdcard"
UBOOT_CONFIG[som_sd_4g]   = "${MACHINE}_som_sd_4g_defconfig,sdcard"

ATF_PLATFORM = "imx8mq"

DDR_FIRMWARE_NAME = "\
    lpddr4_pmu_train_1d_imem.bin \
    lpddr4_pmu_train_1d_dmem.bin \
    lpddr4_pmu_train_2d_imem.bin \
    lpddr4_pmu_train_2d_dmem.bin \
"

IMAGE_BOOT_FILES:append = " \
	boot.scr-${MACHINE};boot.scr \
	upgrade.scr-${MACHINE};upgrade.scr \
	flash.bin-${MACHINE}-2g;u-boot.${MACHINE}_2g \
	flash.bin-${MACHINE}-2gr0;u-boot.${MACHINE}_2gr0 \
	flash.bin-${MACHINE}-4g;u-boot.${MACHINE}_4g \
	flash.bin-${MACHINE}-som_2g;u-boot.${MACHINE}_som_2g \
	flash.bin-${MACHINE}-som_2gr0;u-boot.${MACHINE}_som_2gr0 \
	flash.bin-${MACHINE}-som_4g;u-boot.${MACHINE}_som_4g \
	flash.bin-${MACHINE}-som_sd_2g;u-boot.${MACHINE}_som_sd_2g \
	flash.bin-${MACHINE}-som_sd_4g;u-boot.${MACHINE}_som_sd_4g \
"

# wic support
WKS_FILE = "sdimage-bootpart.wks"
WKS_FILE_DEPENDS += "u-boot-script-boundary"

SERIAL_CONSOLES ?= "115200;ttymxc0"

MACHINE_FEATURES += " pci wifi bluetooth"
```

## conf/machine/nitrogen8mm.conf
```bitbake
#@TYPE: Machine
#@NAME: Boundary Devices Nitrogen8MM
#@SOC: i.MX8MM
#@DESCRIPTION: Machine configuration for Boundary Devices Nitrogen8MM
#@MAINTAINER: Chris Dimich <chris.dimich@boundarydevices.com>

MACHINEOVERRIDES =. "mx8mm:"

IMX_DEFAULT_BSP ?= "nxp"

require conf/machine/include/imx-base.inc
require conf/machine/include/arm/armv8a/tune-cortexa53.inc

# Kernel configuration
PREFERRED_PROVIDER_virtual/kernel ??= "linux-boundary"
KERNEL_DEVICETREE = "\
	freescale/imx8mm-nitrogen8mm.dtb \
	freescale/imx8mm-nitrogen8mm-m4.dtb \
	freescale/imx8mm-nitrogen8mm-tc358743.dtb \
	freescale/imx8mm-nitrogen8mm_rev2.dtb \
	freescale/imx8mm-nitrogen8mm_rev2-m4.dtb \
	freescale/imx8mm-nitrogen8mm_rev2-tc358743.dtb \
	freescale/imx8mm-nitrogen8mm_som.dtb \
	freescale/imx8mm-nitrogen8mm_som-m4.dtb \
	freescale/imx8mm-nitrogen8mm_som-mcp2518fd.dtb \
	freescale/imx8mm-nitrogen8mm_som-mcp25625.dtb \
	freescale/imx8mm-nitrogen8mm_som-tc358743.dtb \
	freescale/imx8mm-nitrogen8mm_tab.dtb \
	freescale/imx8mm-nitrogen_smarc.dtb \
"
KERNEL_IMAGETYPE = "Image"
RRECOMMENDS:${KERNEL_PACKAGE_NAME}-base = ""

# U-Boot configuration
IMX_DEFAULT_BOOTLOADER:imx-nxp-bsp = "u-boot-boundary"
PREFERRED_PROVIDER_u-boot ??= "u-boot-boundary"
PREFERRED_PROVIDER_virtual/bootloader ??= "u-boot-boundary"
PREFERRED_PROVIDER_imx-atf ??= "imx-atf-boundary"
SPL_BINARY = "spl/u-boot-spl.bin"
UBOOT_SUFFIX = "bin"

UBOOT_CONFIG ??= "2g 2gr0 4g rev2_2g rev2_2gr0 rev2_4g som_1gr0 som_2g som_2gr0 som_4g smarc_2gr0"
UBOOT_CONFIG[2g]       = "${MACHINE}_2g_defconfig,sdcard"
UBOOT_CONFIG[2gr0]     = "${MACHINE}_2gr0_defconfig,sdcard"
UBOOT_CONFIG[4g]       = "${MACHINE}_4g_defconfig,sdcard"
UBOOT_CONFIG[rev2_2g]  = "${MACHINE}_rev2_2g_defconfig,sdcard"
UBOOT_CONFIG[rev2_2gr0]  = "${MACHINE}_rev2_4g_defconfig,sdcard"
UBOOT_CONFIG[rev2_4g]     = "${MACHINE}_2gr0_defconfig,sdcard"
UBOOT_CONFIG[som_1gr0] = "${MACHINE}_som_1gr0_defconfig,sdcard"
UBOOT_CONFIG[som_2g]   = "${MACHINE}_som_2g_defconfig,sdcard"
UBOOT_CONFIG[som_2gr0]   = "${MACHINE}_som_2g_defconfig,sdcard"
UBOOT_CONFIG[som_4g]   = "${MACHINE}_som_4g_defconfig,sdcard"
UBOOT_CONFIG[smarc_2gr0]   = "imx8mm_nitrogen_smarc_2gr0_defconfig,sdcard"

ATF_PLATFORM = "imx8mm"

# Set DDR FIRMWARE
DDR_FIRMWARE_NAME = "\
    lpddr4_pmu_train_1d_imem.bin \
    lpddr4_pmu_train_1d_dmem.bin \
    lpddr4_pmu_train_2d_imem.bin \
    lpddr4_pmu_train_2d_dmem.bin \
"

IMAGE_BOOT_FILES:append = " \
	boot.scr-${MACHINE};boot.scr \
	upgrade.scr-${MACHINE};upgrade.scr \
	flash.bin-${MACHINE}-2g;u-boot.${MACHINE}_2g \
	flash.bin-${MACHINE}-2gr0;u-boot.${MACHINE}_2gr0 \
	flash.bin-${MACHINE}-4g;u-boot.${MACHINE}_4g \
	flash.bin-${MACHINE}-rev2_2g;u-boot.${MACHINE}_rev2_2g \
	flash.bin-${MACHINE}-rev2_2gr0;u-boot.${MACHINE}_rev2_2gr0 \
	flash.bin-${MACHINE}-rev2_4g;u-boot.${MACHINE}_rev2_4g \
	flash.bin-${MACHINE}-som_1gr0;u-boot.${MACHINE}_som_1gr0 \
	flash.bin-${MACHINE}-som_2g;u-boot.${MACHINE}_som_2g \
	flash.bin-${MACHINE}-som_2gr0;u-boot.${MACHINE}_som_2gr0 \
	flash.bin-${MACHINE}-som_4g;u-boot.${MACHINE}_som_4g \
	flash.bin-${MACHINE}-smarc_2gr0;u-boot.imx8mm_nitrogen_smarc_2gr0 \
"

# wic support
WKS_FILE = "sdimage-bootpart.wks"
WKS_FILE_DEPENDS += "u-boot-script-boundary"

SERIAL_CONSOLES = "115200;ttymxc1"

MACHINE_FEATURES += " pci wifi bluetooth"
```

## conf/machine/nitrogen8mn.conf
```bitbake
#@TYPE: Machine
#@NAME: Boundary Devices Nitrogen8M Nano
#@SOC: i.MX8 Nano
#@DESCRIPTION: Machine configuration for Boundary Devices Nitrogen8M Nano
#@MAINTAINER: Chris Dimich <chris.dimich@boundarydevices.com>

MACHINEOVERRIDES =. "mx8mn:"

IMX_DEFAULT_BSP ?= "nxp"

require conf/machine/include/imx-base.inc
require conf/machine/include/arm/armv8a/tune-cortexa53.inc

# Kernel configuration
PREFERRED_PROVIDER_virtual/kernel ??= "linux-boundary"
KERNEL_DEVICETREE = "freescale/imx8mn-nitrogen8mn.dtb \
	freescale/imx8mn-nitrogen8mn_som.dtb \
	freescale/imx8mn-nitrogen8mn_som-m4.dtb \
	freescale/imx8mn-nitrogen8_nano.dtb \
	freescale/imx8mn-nitrogen8_nano-m4.dtb \
"

KERNEL_IMAGETYPE = "Image"
KERNEL_DEFCONFIG = "boundary_defconfig"
RRECOMMENDS:${KERNEL_PACKAGE_NAME}-base = ""

# U-Boot configuration
IMX_DEFAULT_BOOTLOADER:imx-nxp-bsp = "u-boot-boundary"
PREFERRED_PROVIDER_u-boot ??= "u-boot-boundary"
PREFERRED_PROVIDER_virtual/bootloader ??= "u-boot-boundary"
PREFERRED_PROVIDER_imx-atf ??= "imx-atf-boundary"
SPL_BINARY = "spl/u-boot-spl.bin"
UBOOT_SUFFIX = "bin"

UBOOT_CONFIG ??= "1g som_1g"
UBOOT_CONFIG[1g]   = "${MACHINE}_1g_defconfig,sdcard"
UBOOT_CONFIG[som_1g] = "${MACHINE}_som_1g_defconfig,sdcard"

ATF_PLATFORM = "imx8mn"

DDR_FIRMWARE_NAME = "\
    lpddr4_pmu_train_1d_imem.bin \
    lpddr4_pmu_train_1d_dmem.bin \
    lpddr4_pmu_train_2d_imem.bin \
    lpddr4_pmu_train_2d_dmem.bin \
"

IMAGE_BOOT_FILES:append = " \
	boot.scr-${MACHINE};boot.scr \
	upgrade.scr-${MACHINE};upgrade.scr \
	flash.bin-${MACHINE}-1g;u-boot.${MACHINE}_1g \
	flash.bin-${MACHINE}-som_1g;u-boot.${MACHINE}_som_1g \
"

# wic support
WKS_FILE = "sdimage-bootpart.wks"
WKS_FILE_DEPENDS += "u-boot-script-boundary"

SERIAL_CONSOLES = "115200;ttymxc1"

MACHINE_FEATURES += " pci wifi bluetooth"
```

## conf/machine/nitrogen8mp.conf
```bitbake
#@TYPE: Machine
#@NAME: Boundary Devices Nitrogen8MP
#@SOC: i.MX8 MP
#@DESCRIPTION: Machine configuration for Boundary Devices Nitrogen8MP
#@MAINTAINER: Chris Dimich <chris.dimich@boundarydevices.com>

MACHINEOVERRIDES =. "mx8mp:"

IMX_DEFAULT_BSP ?= "nxp"

require conf/machine/include/imx-base.inc
require conf/machine/include/arm/armv8a/tune-cortexa53.inc

# Kernel configuration
PREFERRED_PROVIDER_virtual/kernel ??= "linux-boundary"
KERNEL_DEVICETREE = "freescale/imx8mp-nitrogen8mp.dtb \
	freescale/imx8mp-nitrogen_smarc.dtb \
	freescale/imx8mp-nitrogen8mp-m4.dtb \
	freescale/imx8mp-nitrogen_smarc-rpmsg.dtb \
	freescale/imx8mp-nitrogen8mp-basler3840-4200.dtb \
	freescale/imx8mp-nitrogen8mp-enc.dtb \
	freescale/imx8mp-nitrogen8mp-enc-m4.dtb \
	freescale/imx8mp-nitrogen8mp-enc-ar.dtb \
	freescale/imx8mp-nitrogen8mp-enc-basler4200-ov5640.dtb \
	freescale/imx8mp-nitrogen8mp-enc-tc358743.dtb \
	freescale/imx8mp-nitrogen8mp_r20.dtb \
	freescale/imx8mp-nitrogen8mp_r20-m4.dtb \
	freescale/imx8mp-nitrogen8mp_r20-basler3840-4200.dtb \
	freescale/imx8mp-nitrogen8mp_r20-enc.dtb \
	freescale/imx8mp-nitrogen8mp_r20-enc-m4.dtb \
	freescale/imx8mp-nitrogen8mp_r20-enc-ar.dtb \
	freescale/imx8mp-nitrogen8mp_r20-enc-basler4200-ov5640.dtb \
	freescale/imx8mp-nitrogen8mp_r20-enc-tc358743.dtb \
	freescale/imx8mp-nitrogen8mp_vm.dtb \
"

KERNEL_IMAGETYPE = "Image"
RRECOMMENDS:${KERNEL_PACKAGE_NAME}-base = ""

# U-Boot configuration
IMX_DEFAULT_BOOTLOADER:imx-nxp-bsp = "u-boot-boundary"
PREFERRED_PROVIDER_u-boot ??= "u-boot-boundary"
PREFERRED_PROVIDER_virtual/bootloader ??= "u-boot-boundary"
PREFERRED_PROVIDER_imx-atf ??= "imx-atf-boundary"
SPL_BINARY = "spl/u-boot-spl.bin"
UBOOT_SUFFIX = "bin"

UBOOT_CONFIG ??= "2g 2gr0 4g 8g smarc_2gr0 smarc_4g smarc_8g"
UBOOT_CONFIG[2g]   = "${MACHINE}_2g_defconfig,sdcard"
UBOOT_CONFIG[2gr0] = "${MACHINE}_2gr0_defconfig,sdcard"
UBOOT_CONFIG[4g]   = "${MACHINE}_4g_defconfig,sdcard"
UBOOT_CONFIG[8g]   = "${MACHINE}_8g_defconfig,sdcard"
UBOOT_CONFIG[smarc_2gr0]   = "imx8mp_nitrogen_smarc_2gr0_defconfig,sdcard"
UBOOT_CONFIG[smarc_4g]   = "imx8mp_nitrogen_smarc_4g_defconfig,sdcard"
UBOOT_CONFIG[smarc_8g]   = "imx8mp_nitrogen_smarc_8g_defconfig,sdcard"

ATF_PLATFORM = "imx8mp"

DDR_FIRMWARE_NAME = "\
    lpddr4_pmu_train_1d_imem_202006.bin \
    lpddr4_pmu_train_1d_dmem_202006.bin \
    lpddr4_pmu_train_2d_imem_202006.bin \
    lpddr4_pmu_train_2d_dmem_202006.bin \
"

IMAGE_BOOT_FILES:append = " \
	boot.scr-${MACHINE};boot.scr \
	upgrade.scr-${MACHINE};upgrade.scr \
	flash.bin-${MACHINE}-2g;u-boot.${MACHINE}_2g \
	flash.bin-${MACHINE}-2gr0;u-boot.${MACHINE}_2gr0 \
	flash.bin-${MACHINE}-4g;u-boot.${MACHINE}_4g \
	flash.bin-${MACHINE}-8g;u-boot.${MACHINE}_8g \
	flash.bin-${MACHINE}-smarc_2gr0;u-boot.imx8mp_nitrogen_smarc_2gr0 \
	flash.bin-${MACHINE}-smarc_4g;u-boot.imx8mp_nitrogen_smarc_4g \
	flash.bin-${MACHINE}-smarc_8g;u-boot.imx8mp_nitrogen_smarc_8g \
"

# wic support
WKS_FILE = "sdimage-bootpart.wks"
WKS_FILE_DEPENDS += "u-boot-script-boundary"

OPTEE_BIN_EXT = "8mp"

SERIAL_CONSOLES = "115200;ttymxc1"

MACHINE_FEATURES += " pci wifi bluetooth"
```

## conf/machine/olimex-imx8mp-evb.conf
```bitbake
#@TYPE: Machine
#@NAME: Olimex iMX8MP-SOM evaluation board
#@SOC: i.MX8MP
#@DESCRIPTION: Machine configuration for Olimex iMX8MP-SOM evaluation board with LPDDR4
#@MAINTAINER: Leon Anavi <leon.anavi@konsulko.com>

require conf/machine/include/imx8mp-evk.inc

KERNEL_DEVICETREE_BASENAME = "imx8mp-olimex"

# NXP kernel has additional DTB files for various board configuration and
# derivates. Include them here for NXP BSP only
KERNEL_DEVICETREE:append:use-nxp-bsp = " \
    freescale/imx8mp-ab2.dtb \
    freescale/imx8mp-evk-basler.dtb \
    freescale/imx8mp-evk-basler-ov2775.dtb \
    freescale/imx8mp-evk-basler-ov5640.dtb \
    freescale/imx8mp-evk-dpdk.dtb \
    freescale/imx8mp-evk-dsp.dtb \
    freescale/imx8mp-evk-dual-basler.dtb \
    freescale/imx8mp-evk-dual-os08a20.dtb \
    freescale/imx8mp-evk-dual-ov2775.dtb \
    freescale/imx8mp-evk-ecspi-slave.dtb \
    freescale/imx8mp-evk-flexcan2.dtb \
    freescale/imx8mp-evk-hifiberry-dacplus.dtb \
    freescale/imx8mp-evk-inmate.dtb \
    freescale/imx8mp-evk-iqaudio-dacplus.dtb \
    freescale/imx8mp-evk-iqaudio-dacpro.dtb \
    freescale/imx8mp-evk-it6263-lvds-dual-channel.dtb \
    freescale/imx8mp-evk-jdi-wuxga-lvds-panel.dtb \
    freescale/imx8mp-evk-ndm.dtb \
    freescale/imx8mp-evk-os08a20.dtb \
    freescale/imx8mp-evk-os08a20-ov5640.dtb \
    freescale/imx8mp-evk-ov2775.dtb \
    freescale/imx8mp-evk-ov2775-ov5640.dtb \
    freescale/imx8mp-evk-pcie-ep.dtb \
    freescale/imx8mp-evk-revA3-8mic-revE.dtb \
    freescale/imx8mp-evk-rm67191.dtb \
    freescale/imx8mp-evk-rm67199.dtb \
    freescale/imx8mp-evk-root.dtb \
    freescale/imx8mp-evk-rpmsg.dtb \
    freescale/imx8mp-evk-rpmsg-lpv.dtb \
    freescale/imx8mp-evk-sof-wm8960.dtb \
    freescale/imx8mp-evk-spdif-lb.dtb \
    freescale/imx8mp-evk-usdhc1-m2.dtb \
    freescale/imx8mp-evk-8mic-swpdm.dtb \
    freescale/imx8mp-olimex.dtb \
"

IMX_DEFAULT_BOOTLOADER:use-nxp-bsp = "u-boot-imx"
IMX_DEFAULT_KERNEL:use-nxp-bsp = "linux-fslc"

UBOOT_CONFIG_BASENAME = "imx8mp_olimex"
UBOOT_CONFIG[fspi] = "${UBOOT_CONFIG_BASENAME}_defconfig"
UBOOT_CONFIG[ndm]  = "${UBOOT_CONFIG_BASENAME}_ndm_defconfig"
UBOOT_DTB_NAME = "imx8mp-evk.dtb"

# Set DDR FIRMWARE
DDR_FIRMWARE_VERSION = "202006"
DDR_FIRMWARE_NAME = " \
    lpddr4_pmu_train_1d_dmem_${DDR_FIRMWARE_VERSION}.bin \
    lpddr4_pmu_train_1d_imem_${DDR_FIRMWARE_VERSION}.bin \
    lpddr4_pmu_train_2d_dmem_${DDR_FIRMWARE_VERSION}.bin \
    lpddr4_pmu_train_2d_imem_${DDR_FIRMWARE_VERSION}.bin \
"

IMXBOOT_TARGETS_BASENAME = "flash_evk"

# Mainline BSP doesn't support LPDDR4 so it must be set to nxp.
# Also this machine isn't supported by u-boot-fslc but imx8mn-evk.inc already
# set the bootloader to u-boot-imx instead when NXP BSP is used.
IMX_DEFAULT_BSP = "nxp"
```

## conf/machine/pcm052.conf
```bitbake
#@TYPE: Machine
#@NAME: Phytec phyCORE Vybrid Development Kit
#@SOC: vf60
#@DESCRIPTION: Machine configuration for Phytec phyCORE Vybrid Development Kit
#@MAINTAINER: Anthony Felice <tony.felice@timesys.com>

include conf/machine/include/imx-base.inc
include conf/machine/include/tune-cortexa5.inc

SOC_FAMILY = "vf:vf60"

PREFERRED_PROVIDER_virtual/kernel = "linux-timesys"
PREFERRED_PROVIDER_virtual/kernel-module-mcc ?= "kernel-module-mcc"
PREFERRED_PROVIDER_virtual/kernel-module-mcc-dev ?= "kernel-module-mcc"

UBOOT_MACHINE = "pcm052_config"

KERNEL_DEVICETREE = "vf610-pcm052.dtb"

SDCARD_ROOTFS ?= "${DEPLOY_DIR_IMAGE}/${IMAGE_NAME}.rootfs.ext3"
IMAGE_FSTYPES ?= "tar.bz2 ext3 sdcard"

SERIAL_CONSOLE = "115200 ttyLP1"

MACHINE_FEATURES = "apm usbgadget usbhost vfat alsa touchscreen"
```

## conf/machine/quartz.conf
```bitbake
#@TYPE: Machine
#@NAME: Device Solutions Quartz Vybrid Development Kit
#@SOC: vf60
#@DESCRIPTION: Machine configuration for Device Solutions Quartz Vybrid Development Kit
#@MAINTAINER: Anthony Felice <tony.felice@timesys.com>

include conf/machine/include/imx-base.inc
include conf/machine/include/tune-cortexa5.inc

SOC_FAMILY = "vf60"

PREFERRED_PROVIDER_virtual/kernel = "linux-timesys"
PREFERRED_PROVIDER_u-boot = "u-boot-timesys"

# The quartz_nand_config target supports both SD and NAND boot.
UBOOT_MACHINE = "quartz_nand_config"

SDCARD_ROOTFS ?= "${DEPLOY_DIR_IMAGE}/${IMAGE_NAME}.rootfs.ext3"
IMAGE_FSTYPES ?= "tar.bz2 ext3 sdcard"

SERIAL_CONSOLE = "115200 ttymxc0"

MACHINE_FEATURES = "apm usbgadget usbhost vfat alsa touchscreen"
```

## conf/machine/tx6q-10x0.conf
```bitbake
#@TYPE: Machine
#@NAME: Ka-Ro electronics i.MX6Q TX6Q Computer-On-Module
#@SOC: i.MX6Q
#@DESCRIPTION: Machine configuration for Ka-Ro electronics TX6Q Computer-On-Module
#@MAINTAINER: Oliver Wendt <ow@karo-electronics.com>

require include/tx6-karo-common.inc

SOC_FAMILY = "mx6:mx6q"

KERNEL_DEVICETREE = "imx6q-tx6q-10x0.dtb"

UBOOT_MACHINE = "tx6q-10x0_config"
```
