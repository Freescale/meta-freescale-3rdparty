## conf/machine/tx6q-11x0.conf
```bitbake
#@TYPE: Machine
#@NAME: Ka-Ro electronics i.MX6Q TX6Q Computer-On-Module
#@SOC: i.MX6Q
#@DESCRIPTION: Machine configuration for Ka-Ro electronics TX6Q Computer-On-Module
#@MAINTAINER: Oliver Wendt <ow@karo-electronics.com>

MACHINEOVERRIDES =. "mx6:mx6q:"

require include/tx6-karo-common.inc

KERNEL_DEVICETREE = "imx6q-tx6q-11x0.dtb"

UBOOT_MACHINE = "tx6q-11x0_config"
```

## conf/machine/tx6s-8034.conf
```bitbake
#@TYPE: Machine
#@NAME: Ka-Ro electronics i.MX6S TX6S Computer-On-Module
#@SOC: i.MX6S
#@DESCRIPTION: Machine configuration for Ka-Ro electronics TX6S Computer-On-Module
#@MAINTAINER: Oliver Wendt <ow@karo-electronics.com>

MACHINEOVERRIDES =. "mx6:mx6dl:"

require include/tx6-karo-common.inc

KERNEL_DEVICETREE = "imx6dl-tx6s-8034.dtb"

UBOOT_MACHINE = "tx6s-8034_config"
```

## conf/machine/tx6u-8033.conf
```bitbake
#@TYPE: Machine
#@NAME: Ka-Ro electronics i.MX6DL TX6DL Computer-On-Module
#@SOC: i.MX6DL
#@DESCRIPTION: Machine configuration for Ka-Ro electronics TX6DL Computer-On-Module
#@MAINTAINER: Oliver Wendt <ow@karo-electronics.com>

MACHINEOVERRIDES =. "mx6:mx6dl:"

require include/tx6-karo-common.inc

KERNEL_DEVICETREE = "imx6dl-tx6u-8033.dtb"

UBOOT_MACHINE = "tx6u-8033_config"
```

## conf/machine/tx6u-80x0.conf
```bitbake
#@TYPE: Machine
#@NAME: Ka-Ro electronics i.MX6DL TX6DL Computer-On-Module
#@SOC: i.MX6DL
#@DESCRIPTION: Machine configuration for Ka-Ro electronics TX6DL Computer-On-Module
#@MAINTAINER: Oliver Wendt <ow@karo-electronics.com>

require include/tx6-karo-common.inc

SOC_FAMILY = "mx6:mx6dl"

KERNEL_DEVICETREE = "imx6dl-tx6u-80xx.dtb"

UBOOT_MACHINE = "tx6u-80x0_config"
```

## conf/machine/ventana.conf
```bitbake
#@TYPE: Machine
#@NAME: i.MX6Q/DL Ventana Platform
#@SOC: i.MX6Q/DL
#@DESCRIPTION: Machine configuration for Gateworks Ventana boards.
#@MAINTAINER: Pushpal Sidhu <psidhu@gateworks.com>

MACHINEOVERRIDES =. "mx6:mx6dl:mx6q:"

require conf/machine/include/imx-base.inc
require conf/machine/include/tune-cortexa9.inc

PREFERRED_PROVIDER_virtual/bootloader = "u-boot-gateworks-imx"
PREFERRED_PROVIDER_u-boot = "u-boot-gateworks-imx"

PREFERRED_PROVIDER_virtual/kernel = "linux-gateworks-imx"
PREFERRED_PROVIDER_kernel = "linux-gateworks-imx"

KERNEL_DEVICETREE  = " \
    imx6q-gw5400-a.dtb \
    imx6q-gw51xx.dtb \
    imx6q-gw52xx.dtb \
    imx6q-gw53xx.dtb \
    imx6q-gw54xx.dtb \
    imx6q-gw551x.dtb \
    imx6q-gw552x.dtb \
    imx6dl-gw51xx.dtb \
    imx6dl-gw52xx.dtb \
    imx6dl-gw53xx.dtb \
    imx6dl-gw54xx.dtb \
    imx6dl-gw551x.dtb \
    imx6dl-gw552x.dtb \
"

KERNEL_IMAGETYPE = "uImage"

MACHINE_FEATURES += "pci wifi bluetooth"

# Add kernel modules
MACHINE_EXTRA_RRECOMMENDS += "\
    kernel-module-sky2 \
"

# Modules autoload
KERNEL_MODULE_AUTOLOAD = "sky2"

# Req'd for boot
MACHINE_ESSENTIAL_EXTRA_RDEPENDS += "\
    kernel-image kernel-devicetree \
    u-boot-script-gateworks-imx \
"

# Bootloader configs:
UBOOT_CONFIG ??= "std"
UBOOT_CONFIG[std] = "gwventana_config"

SERIAL_CONSOLE = "115200 ttymxc1"

# Override FS Type Creation
IMAGE_FSTYPES = "tar.bz2 multiubi"

# Build the following sizes
MULTIUBI_BUILD ?= "normal large"

UBI_VOLNAME = "rootfs"

# 256MB ('normal' flash layout)
export MKUBIFS_ARGS_normal = "-F -m 2048 -e 124KiB -c 1912 -x zlib"
export UBINIZE_ARGS_normal = "-m 2048 -p 128KiB -s 2048"

# 2GB ('large' flash layout)
export MKUBIFS_ARGS_large = "-F -m 4096 -e 248KiB -c 8124 -x zlib"
export UBINIZE_ARGS_large = "-m 4096 -p 256KiB -s 4096"
```

## conf/machine/wandboard-dual.conf
```bitbake
#@TYPE: Machine
#@NAME: Wandboard i.MX6 Wandboard Duallite
#@SOC: i.MX6DL
#@DESCRIPTION: Machine configuration for i.MX6 Wandboard Duallite
#@MAINTAINER: Alfonso Tames <alfonso@tames.com>

include include/wandboard.inc

SOC_FAMILY = "mx6:mx6dl:wandboard"

UBOOT_MACHINE = "wandboard_dl_config"

KERNEL_DEVICETREE = "imx6dl-wandboard.dtb"

MACHINE_FEATURES += "bluetooth wifi"

MACHINE_EXTRA_RRECOMMENDS += " \
  bcm4329-nvram-config \
  bcm4330-nvram-config \
"
```

## conf/machine/wandboard-quad.conf
```bitbake
#@TYPE: Machine
#@NAME: Wandboard i.MX6 Wandboard Quad
#@SOC: i.MX6Q
#@DESCRIPTION: Machine configuration for i.MX6 Wandboard Quad
#@MAINTAINER: Alfonso Tames <alfonso@tames.com>

include include/wandboard.inc

SOC_FAMILY = "mx6:mx6q:wandboard"

UBOOT_MACHINE = "wandboard_quad_config"

KERNEL_DEVICETREE = "imx6q-wandboard.dtb"

MACHINE_FEATURES += "bluetooth wifi"

MACHINE_EXTRA_RRECOMMENDS += " \
  bcm4329-nvram-config \
  bcm4330-nvram-config \
"
```

## conf/machine/wandboard-solo.conf
```bitbake
#@TYPE: Machine
#@NAME: Wandboard i.MX6 Wandboard Solo
#@SOC: i.MX6S
#@DESCRIPTION: Machine configuration for i.MX6 Wandboard Solo
#@MAINTAINER: Alfonso Tames <alfonso@tames.com>

include include/wandboard.inc

SOC_FAMILY = "mx6:mx6dl:wandboard"

UBOOT_MACHINE = "wandboard_solo_config"

KERNEL_DEVICETREE = "imx6dl-wandboard.dtb"
```

## conf/machine/wandboard.conf
```bitbake
#@TYPE: Machine
#@NAME: Wandboard i.MX6 Wandboard QuadPlus/Quad/Dual/Solo
#@SOC: i.MX6QP/Q/DL
#@DESCRIPTION: Machine configuration for i.MX6 Wandboard QuadPlus/Quad/Dual/Solo
#@MAINTAINER: Alfonso Tames <alfonso@tames.com>

MACHINEOVERRIDES =. "mx6q:mx6dl:"

include conf/machine/include/imx-base.inc
include conf/machine/include/arm/armv7a/tune-cortexa9.inc

IMX_DEFAULT_BSP = "mainline"

UBOOT_MAKE_TARGET = ""
UBOOT_SUFFIX = "img"
SPL_BINARY = "SPL"
UBOOT_MACHINE = "wandboard_config"

UBOOT_EXTLINUX = "1"
UBOOT_EXTLINUX_ROOT = "root=PARTUUID=${uuid}"
UBOOT_EXTLINUX_CONSOLE = "console=${console},${baudrate}"

WANDBOARD_DEFAULT_KERNEL = "linux-wandboard"
WANDBOARD_DEFAULT_KERNEL:use-mainline-bsp = "linux-fslc"
PREFERRED_PROVIDER_virtual/kernel ?= "${WANDBOARD_DEFAULT_KERNEL}"
KERNEL_DEVICETREE = " \
    nxp/imx/imx6dl-wandboard.dtb \
    nxp/imx/imx6dl-wandboard-revb1.dtb \
    nxp/imx/imx6dl-wandboard-revd1.dtb \
    nxp/imx/imx6q-wandboard.dtb \
    nxp/imx/imx6q-wandboard-revb1.dtb \
    nxp/imx/imx6q-wandboard-revd1.dtb \
    nxp/imx/imx6qp-wandboard-revd1.dtb \
"

KERNEL_IMAGETYPE = "zImage"

MACHINE_FEATURES += "bluetooth pci wifi touchscreen"

MACHINE_EXTRA_RRECOMMENDS += " \
  bcm4329-nvram-config \
  bcm4330-nvram-config \
"

SERIAL_CONSOLES = "115200;ttymxc0"

MACHINE_ESSENTIAL_EXTRA_RDEPENDS += " \
    kernel-image \
    kernel-devicetree \
    u-boot-fslc \
"

WKS_FILES = "imx-uboot-spl.wks.in"
```

## recipes-kernel/linux/linux-cfa-3.12/defconfig
```kconfig
CONFIG_SYSVIPC=y
CONFIG_NO_HZ=y
CONFIG_HIGH_RES_TIMERS=y
CONFIG_TASKSTATS=y
CONFIG_TASK_DELAY_ACCT=y
CONFIG_TASK_XACCT=y
CONFIG_TASK_IO_ACCOUNTING=y
CONFIG_IKCONFIG=y
CONFIG_IKCONFIG_PROC=y
# CONFIG_UTS_NS is not set
# CONFIG_IPC_NS is not set
# CONFIG_PID_NS is not set
# CONFIG_NET_NS is not set
CONFIG_KALLSYMS_ALL=y
CONFIG_PERF_EVENTS=y
# CONFIG_COMPAT_BRK is not set
CONFIG_MODULES=y
CONFIG_MODULE_FORCE_LOAD=y
CONFIG_MODULE_UNLOAD=y
CONFIG_MODULE_FORCE_UNLOAD=y
CONFIG_MODVERSIONS=y
CONFIG_BLK_DEV_INTEGRITY=y
# CONFIG_IOSCHED_DEADLINE is not set
# CONFIG_IOSCHED_CFQ is not set
# CONFIG_ARCH_MULTI_V7 is not set
CONFIG_GPIO_PCA953X=y
CONFIG_ARCH_MXS=y
# CONFIG_ARM_THUMB is not set
CONFIG_PREEMPT_VOLUNTARY=y
CONFIG_AEABI=y
# CONFIG_COMPACTION is not set
CONFIG_DEFAULT_MMAP_MIN_ADDR=65536
CONFIG_CMA=y
CONFIG_FPE_NWFPE=y
CONFIG_NET=y
CONFIG_PACKET=y
CONFIG_UNIX=y
CONFIG_INET=y
CONFIG_IP_PNP=y
CONFIG_IP_PNP_DHCP=y
CONFIG_SYN_COOKIES=y
# CONFIG_INET_XFRM_MODE_TRANSPORT is not set
# CONFIG_INET_XFRM_MODE_TUNNEL is not set
# CONFIG_INET_XFRM_MODE_BEET is not set
# CONFIG_INET_LRO is not set
# CONFIG_INET_DIAG is not set
# CONFIG_IPV6 is not set
CONFIG_DEVTMPFS=y
CONFIG_DEVTMPFS_MOUNT=y
# CONFIG_FIRMWARE_IN_KERNEL is not set
CONFIG_DMA_CMA=y
# CONFIG_BLK_DEV is not set
CONFIG_CFAFIQ=y
CONFIG_SCSI=y
CONFIG_BLK_DEV_SD=y
CONFIG_NETDEVICES=y
# CONFIG_NET_VENDOR_ARC is not set
CONFIG_ENC28J60=y
# CONFIG_NET_VENDOR_VIA is not set
# CONFIG_WLAN is not set
# CONFIG_INPUT_MOUSEDEV_PSAUX is not set
CONFIG_INPUT_EVDEV=y
# CONFIG_KEYBOARD_ATKBD is not set
CONFIG_KEYBOARD_GPIO=y
# CONFIG_INPUT_MOUSE is not set
CONFIG_INPUT_MISC=y
CONFIG_INPUT_GPIO_ROTARY_ENCODER=y
# CONFIG_SERIO is not set
CONFIG_VT_HW_CONSOLE_BINDING=y
CONFIG_DEVPTS_MULTIPLE_INSTANCES=y
# CONFIG_LEGACY_PTYS is not set
# CONFIG_DEVKMEM is not set
CONFIG_SERIAL_AMBA_PL011=y
CONFIG_SERIAL_AMBA_PL011_CONSOLE=y
# CONFIG_HW_RANDOM is not set
CONFIG_I2C=y
# CONFIG_I2C_COMPAT is not set
CONFIG_I2C_CHARDEV=y
CONFIG_I2C_MUX=y
CONFIG_I2C_MUX_GPIO=y
CONFIG_I2C_GPIO=y
CONFIG_I2C_MXS=y
CONFIG_SPI=y
CONFIG_SPI_GPIO=y
CONFIG_SPI_MXS=y
CONFIG_SPI_SPIDEV=y
CONFIG_GPIO_SYSFS=y
CONFIG_GPIO_PCA953X_IRQ=y
CONFIG_GPIO_74X164=y
CONFIG_W1=y
CONFIG_W1_MASTER_GPIO=y
CONFIG_W1_SLAVE_THERM=y
CONFIG_SENSORS_IIO_HWMON=y
CONFIG_SENSORS_MXS_CPU=y
CONFIG_REGULATOR=y
CONFIG_REGULATOR_FIXED_VOLTAGE=y
CONFIG_FB=y
CONFIG_FB_MXS=y
CONFIG_BACKLIGHT_LCD_SUPPORT=y
CONFIG_LCD_CLASS_DEVICE=y
CONFIG_LCD_HX8357=y
CONFIG_BACKLIGHT_CLASS_DEVICE=y
# CONFIG_BACKLIGHT_GENERIC is not set
CONFIG_BACKLIGHT_PWM=y
CONFIG_FB_SSD1307=y
CONFIG_USB=y
CONFIG_USB_ANNOUNCE_NEW_DEVICES=y
CONFIG_USB_EHCI_HCD=y
CONFIG_USB_ACM=y
CONFIG_USB_STORAGE=y
CONFIG_USB_CHIPIDEA=y
CONFIG_USB_CHIPIDEA_UDC=y
CONFIG_USB_CHIPIDEA_HOST=y
CONFIG_USB_MXS_PHY=y
CONFIG_USB_GADGET=y
CONFIG_USB_ETH=y
CONFIG_USB_ETH_EEM=y
CONFIG_MMC=y
CONFIG_MMC_MXS=y
CONFIG_NEW_LEDS=y
CONFIG_LEDS_CLASS=y
CONFIG_LEDS_GPIO=y
CONFIG_LEDS_TRIGGERS=y
CONFIG_LEDS_TRIGGER_HEARTBEAT=y
CONFIG_LEDS_TRIGGER_DEFAULT_ON=y
CONFIG_RTC_CLASS=y
CONFIG_RTC_DRV_DS1307=m
CONFIG_DMADEVICES=y
CONFIG_MXS_DMA=y
CONFIG_STAGING=y
CONFIG_MXS_LRADC=y
CONFIG_IIO=y
CONFIG_NAU7802=y
CONFIG_PWM_MXS=y
CONFIG_EXT3_FS=y
# CONFIG_DNOTIFY is not set
CONFIG_FSCACHE=m
CONFIG_FSCACHE_STATS=y
CONFIG_CACHEFILES=m
CONFIG_TMPFS=y
CONFIG_TMPFS_POSIX_ACL=y
# CONFIG_MISC_FILESYSTEMS is not set
CONFIG_NFS_FS=y
CONFIG_NFS_V3_ACL=y
CONFIG_NFS_V4=y
CONFIG_ROOT_NFS=y
CONFIG_PRINTK_TIME=y
CONFIG_DEBUG_INFO=y
CONFIG_FRAME_WARN=2048
CONFIG_UNUSED_SYMBOLS=y
CONFIG_MAGIC_SYSRQ=y
CONFIG_DEBUG_KERNEL=y
CONFIG_LOCKUP_DETECTOR=y
CONFIG_SCHEDSTATS=y
CONFIG_TIMER_STATS=y
CONFIG_BLK_DEV_IO_TRACE=y
CONFIG_STRICT_DEVMEM=y
CONFIG_DEBUG_USER=y
CONFIG_DEBUG_LL=y
CONFIG_DEBUG_IMX28_UART=y
CONFIG_EARLY_PRINTK=y
CONFIG_CRYPTO_CRC32C=m
CONFIG_CRYPTO_ARC4=y
# CONFIG_CRYPTO_ANSI_CPRNG is not set
# CONFIG_CRYPTO_HW is not set
CONFIG_CRC16=y
CONFIG_CRC_ITU_T=m
CONFIG_CRC7=m
CONFIG_AVERAGE=y
```
